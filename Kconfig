## init-manager/Kconfig
```kconfig
# SPDX-License-Identifier: LGPL-2.1-only AND CC-BY-SA-2.0-UK
# SPDX-FileCopyrightText: Copyright 2024,2026 Gaël PORTAY
# SPDX-FileCopyrightText: The OpenEmbedded Contributors
#
# The help texts are stolen from the Yocto Project Development Tasks Manual.
#
# https://docs.yoctoproject.org/next/dev-manual/index.html
# https://docs.yoctoproject.org/dev/dev-manual/init-manager.html

menu "Initialization Manager"

choice
	prompt "Initialization Manager"
	default IS_INIT_MANAGER_SYSTEMD

config IS_INIT_MANAGER_MDEV_BUSYBOX
	bool "mdev-busybox"
	help
	  BusyBox init with BusyBox mdev is the simplest and lightest
	  solution for small root filesystems.

	  https://github.com/openembedded/openembedded-core/tree/master/meta/conf/distro/include/init-manager-mdev-busybox.inc

config IS_INIT_MANAGER_SYSVINIT
	bool "sysvinit"
	help
	  SysVinit with the udev device manager.

	  https://github.com/openembedded/openembedded-core/tree/master/meta/conf/distro/include/init-manager-sysvinit.inc

config IS_INIT_MANAGER_SYSTEMD
	bool "systemd"
	select HAS_DISTRO_FEATURE_SYSTEMD
	select HAS_DISTRO_FEATURE_USRMERGE # scarthgap-and-later
	help
	  The last option is to use systemd together with the udev
	  device manager. This is the most powerful and versatile
	  solution, especially for more complex systems.

	  This will enable systemd and remove sysvinit components from
	  the image.

	  See meta/conf/distro/include/init-manager-systemd.inc for
	  exact details on what this does.

	  https://github.com/openembedded/openembedded-core/tree/master/meta/conf/distro/include/init-manager-systemd.inc

	  Important: Since scarthgap, usrmerge is now required by
	  systemd, ensure this is also added to DISTRO_FEATURES when
	  systemd is selected.

	  https://github.com/openembedded/openembedded-core/commit/fa8c59c49940af4cb03df49f5b6a2a53d50fbefb

config IS_INIT_MANAGER_NONE
	bool "none"
	help
	  https://github.com/openembedded/openembedded-core/tree/master/meta/conf/distro/include/init-manager-none.inc

endchoice

config KAS_INCLUDE_IS_INIT_MANAGER
	string
	default "init-manager/mdev-busybox.yaml" if IS_INIT_MANAGER_MDEV_BUSYBOX
	default "init-manager/sysvinit.yaml" if IS_INIT_MANAGER_SYSVINIT
	default "init-manager/systemd.yaml" if IS_INIT_MANAGER_SYSTEMD
	default "init-manager/none.yaml"

endmenu
```

## init-system/Kconfig
```kconfig
# SPDX-License-Identifier: LGPL-2.1-only
# SPDX-FileCopyrightText: Copyright 2024 Gaël PORTAY

choice
        prompt "Init system"
        default INIT_SYSTEMD

config INIT_MDEV_BUSYBOX
        bool "mdev-busybox"

config INIT_SYSVINIT
        bool "sysvinit"

config INIT_SYSTEMD
        bool "systemd"

config INIT_NONE
        bool "none"

endchoice

config KAS_INCLUDE_INIT
        string
        default "init-system/mdev-busybox.yaml" if INIT_MDEV_BUSYBOX
        default "init-system/systemd.yaml" if INIT_SYSTEMD
        default "init-system/sysvinit.yaml" if INIT_SYSVINIT
        default "init-system/none"
```

## layers/Kconfig
```kconfig
# SPDX-License-Identifier: LGPL-2.1-only
# SPDX-FileCopyrightText: Copyright 2024-2026 Gaël PORTAY

menu "Layers"

choice
	prompt "OpenEmbedded-Core"
	default IS_OPENEMBEDDED_CORE_POKY if IS_BRANCH_SCARTHGAP
	default IS_OPENEMBEDDED_CORE_OPENEMBEDDED_CORE

config IS_OPENEMBEDDED_CORE_OPENEMBEDDED_CORE
	bool "openembedded-core"
	select HAS_LAYER_BITBAKE
	select HAS_LAYER_OPENEMBEDDED_CORE
	select HAS_LAYER_OPENEMBEDDED_CORE_META
	help
	  https://git.openembedded.org/openembedded-core/

config IS_OPENEMBEDDED_CORE_POKY
	bool "poky"
	depends on IS_BRANCH_SCARTHGAP
	select HAS_LAYER_POKY
	select HAS_LAYER_POKY_META
	help
	  https://git.yoctoproject.org/poky

endchoice

source "layers/poky/Kconfig"
source "layers/bitbake/Kconfig"
source "layers/openembedded-core/Kconfig"
source "layers/meta-yocto/Kconfig"
source "layers/meta-openembedded/Kconfig"
source "layers/meta-security/Kconfig"
source "layers/meta-clang/Kconfig"
source "layers/meta-lts-mixins/Kconfig"
source "layers/meta-rauc/Kconfig"
source "layers/meta-rauc-community/Kconfig"
source "layers/meta-aws/Kconfig"
source "layers/meta-arm/Kconfig"
source "layers/meta-freescale/Kconfig"
source "layers/meta-riscv/Kconfig"
source "layers/meta-coral/Kconfig"
source "layers/meta-raspberrypi/Kconfig"
source "layers/this/Kconfig"
endmenu
```

## layers/bitbake/Kconfig
```kconfig
# SPDX-License-Identifier: LGPL-2.1-only
# SPDX-FileCopyrightText: Copyright 2025-2026 Gaël PORTAY

config HAS_LAYER_BITBAKE
	bool "bitbake"
	help
	  BitBake is a generic task execution engine that allows shell
	  and Python tasks to be run efficiently and in parallel while
	  working within complex inter-task dependency constraints.

	  https://git.openembedded.org/bitbake/

config KAS_INCLUDE_HAS_LAYER_BITBAKE
	string
	depends on HAS_LAYER_BITBAKE
	default "layers/bitbake/bitbake.yaml"

if HAS_LAYER_BITBAKE

choice
	prompt "bitbake"
	default IS_BITBAKE_2_8 if IS_BRANCH_SCARTHGAP
	default IS_BITBAKE_2_18 if IS_BRANCH_WRYNOSE
	default IS_BITBAKE_2_18 if IS_BRANCH_MASTER
	default IS_BITBAKE_MASTER
	help
	  BitBake is a generic task execution engine that allows shell
	  and Python tasks to be run efficiently and in parallel while
	  working within complex inter-task dependency constraints.

	  https://git.openembedded.org/bitbake/
	  https://wiki.yoctoproject.org/wiki/Releases

config IS_BITBAKE_2_0
	bool "2.0"

config IS_BITBAKE_2_2
	bool "2.2"

config IS_BITBAKE_2_4
	bool "2.4"

config IS_BITBAKE_2_6
	bool "2.6"

config IS_BITBAKE_2_8
	bool "2.8"

config IS_BITBAKE_2_10
	bool "2.10"

config IS_BITBAKE_2_12
	bool "2.12"

config IS_BITBAKE_2_16
	bool "2.16"

config IS_BITBAKE_2_18
	bool "2.18"

config IS_BITBAKE_MASTER
	bool "master"

endchoice

config KAS_INCLUDE_HAS_LAYER_BITBAKE_BRANCH
	string
	depends on IS_OPENEMBEDDED_CORE_OPENEMBEDDED_CORE
	default "layers/bitbake/bitbake-2.0.yaml" if IS_BITBAKE_2_0
	default "layers/bitbake/bitbake-2.2.yaml" if IS_BITBAKE_2_2
	default "layers/bitbake/bitbake-2.4.yaml" if IS_BITBAKE_2_4
	default "layers/bitbake/bitbake-2.6.yaml" if IS_BITBAKE_2_6
	default "layers/bitbake/bitbake-2.8.yaml" if IS_BITBAKE_2_8
	default "layers/bitbake/bitbake-2.10.yaml" if IS_BITBAKE_2_10
	default "layers/bitbake/bitbake-2.12.yaml" if IS_BITBAKE_2_12
	default "layers/bitbake/bitbake-2.14.yaml" if IS_BITBAKE_2_14
	default "layers/bitbake/bitbake-2.16.yaml" if IS_BITBAKE_2_16
	default "layers/bitbake/bitbake-2.18.yaml" if IS_BITBAKE_2_18
	default "layers/bitbake/bitbake-master.yaml" if IS_BITBAKE_MASTER
	default ""

endif # HAS_LAYER_BITBAKE
```

## layers/meta-arm/Kconfig
```kconfig
# SPDX-License-Identifier: LGPL-2.1-only
# SPDX-FileCopyrightText: Copyright 2024 Gaël PORTAY

config HAS_LAYER_META_ARM
	bool "meta-arm"
	help
	  Layer containing support for Arm products

	  https://git.yoctoproject.org/meta-arm/

config KAS_INCLUDE_LAYER_META_ARM
	string
	depends on HAS_LAYER_META_ARM
	default "layers/meta-arm/meta-arm.yaml"

if HAS_LAYER_META_ARM

config HAS_LAYER_META_ARM_META_ARM
	bool "meta-arm"
	select HAS_LAYER_POKY_META
	select HAS_LAYER_META_ARM_META_ARM_TOOLCHAIN
	help
	  https://git.yoctoproject.org/meta-arm/tree/meta-arm

config KAS_INCLUDE_LAYER_META_ARM_META_ARM
	string
	depends on HAS_LAYER_META_ARM_META_ARM
	default "layers/meta-arm/meta-arm-meta-arm.yaml"

config HAS_LAYER_META_ARM_META_ARM_TOOLCHAIN
	bool "meta-arm-toolchain"
	select HAS_LAYER_POKY_META
	help
	  https://git.yoctoproject.org/meta-arm/tree/meta-arm-toolchain

config KAS_INCLUDE_LAYER_META_ARM_META_ARM_TOOLCHAIN
	string
	depends on HAS_LAYER_META_ARM_META_ARM_TOOLCHAIN
	default "layers/meta-arm/meta-arm-meta-arm-toolchain.yaml"

endif # HAS_LAYER_META_ARM
```

## layers/meta-aws/Kconfig
```kconfig
# SPDX-License-Identifier: LGPL-2.1-only
# SPDX-FileCopyrightText: Copyright 2024 Gaël PORTAY

config HAS_LAYER_META_AWS
	bool "meta-aws"
	select HAS_LAYER_POKY_META
	select HAS_LAYER_META_OPENEMBEDDED
	select HAS_LAYER_META_OPENEMBEDDED_META_OE
	select HAS_LAYER_META_OPENEMBEDDED_META_PYTHON
	select HAS_LAYER_META_OPENEMBEDDED_META_NETWORKING
	select HAS_LAYER_META_OPENEMBEDDED_META_MULTIMEDIA
	help
	  The metadata layer for baking AWS device software to Embedded
	  Linux distributions built by the Yocto Project build system.

config KAS_INCLUDE_HAS_LAYER_META_AWS
	string
	depends on HAS_LAYER_META_AWS
	default "layers/meta-aws/meta-aws.yaml"
```

## layers/meta-browser/Kconfig
```kconfig
# SPDX-License-Identifier: LGPL-2.1-only
# SPDX-FileCopyrightText: Copyright 2026 Gaël PORTAY

config HAS_LAYER_META_BROWSER
	bool "meta-browser"
	help
	  OpenEmbedded/Yocto BSP layer for Web Browsers.

	  https://github.com/OSSystems/meta-browser

config KAS_INCLUDE_HAS_LAYER_META_BROWSER
	string
	depends on HAS_LAYER_META_BROWSER
	default "layers/meta-browser/meta-browser.yaml"

if HAS_LAYER_META_BROWSER

config HAS_LAYER_META_BROWSER_META_CHROMIUM
	bool "meta-chromium"
#	depends on HAS_LAYER_META_RAUC
#	default y if IS_MACHINE_RASPBERRYPI
	help
	  https://github.com/OSSystems/meta-browser/tree/master/meta-chromium

config KAS_INCLUDE_HAS_LAYER_META_BROWSER_META_CHROMIUM
	string
	depends on HAS_LAYER_META_BROWSER_META_CHROMIUM
	default "layers/meta-browser/meta-chromium.yaml"

endif # HAS_LAYER_META_BROWSER
```

## layers/meta-clang/Kconfig
```kconfig
# SPDX-License-Identifier: LGPL-2.1-only
# SPDX-FileCopyrightText: Copyright 2024-2025 Gaël PORTAY

config HAS_LAYER_META_CLANG
	bool "meta-clang"
	help
	  Clang C/C++ cross compiler and runtime for OpenEmbedded/Yocto
	  Project.

config KAS_INCLUDE_HAS_LAYER_META_CLANG
	string
	depends on HAS_LAYER_META_CLANG
	default "layers/meta-clang/meta-clang.yaml"
```

## layers/meta-coral/Kconfig
```kconfig
# SPDX-License-Identifier: LGPL-2.1-only
# SPDX-FileCopyrightText: Copyright 2024 Gaël PORTAY

config HAS_LAYER_META_CORAL
	bool "meta-coral"
	select HAS_LAYER_POKY_META
	select HAS_LAYER_META_FREESCALE
	select HAS_LAYER_META_CLANG
	select HAS_QUIRK_REMOVE_LINUX_CORAL_QA_ERRORS
	help
	  Yocto/OE-core BSP Layer for Coral Dev Board.

config KAS_INCLUDE_HAS_LAYER_META_CORAL
	string
	depends on HAS_LAYER_META_CORAL
	default "layers/meta-coral/meta-coral.yaml"
```

## layers/meta-flutter/Kconfig
```kconfig
# SPDX-License-Identifier: LGPL-2.1-only
# SPDX-FileCopyrightText: Copyright 2025 Gaël PORTAY

config HAS_LAYER_META_FLUTTER
	bool "meta-flutter"
	select HAS_LAYER_POKY_META
	select HAS_LAYER_META_OPENEMBEDDED
	select HAS_LAYER_META_OPENEMBEDDED_META_OE
	select HAS_LAYER_META_CLANG
	help
	  Yocto Layer for Google Flutter related projects.

config KAS_INCLUDE_HAS_LAYER_META_FLUTTER
	string
	depends on HAS_LAYER_META_FLUTTER
	default "layers/meta-flutter/meta-flutter.yaml"
```

## layers/meta-freescale/Kconfig
```kconfig
# SPDX-License-Identifier: LGPL-2.1-only
# SPDX-FileCopyrightText: Copyright 2024-2026 Gaël PORTAY

config HAS_LAYER_META_FREESCALE
	bool "meta-freescale"
	help
	  Layer containing NXP hardware support metadata.

config KAS_INCLUDE_HAS_LAYER_META_FREESCALE
	string
	depends on HAS_LAYER_META_FREESCALE
	default "layers/meta-freescale/meta-freescale.yaml"
```

## layers/meta-intel/Kconfig
```kconfig
# SPDX-License-Identifier: LGPL-2.1-only
# SPDX-FileCopyrightText: Copyright 2026 Gaël PORTAY

config HAS_LAYER_META_INTEL
	bool "meta-intel"
	help
	  Layer containing Intel hardware support metadata

	  https://git.yoctoproject.org/meta-intel/

config KAS_INCLUDE_HAS_LAYER_META_INTEL
	string
	depends on HAS_LAYER_META_INTEL
	default "layers/meta-intel/meta-intel.yaml"
```

## layers/meta-lts-mixins/Kconfig
```kconfig
# SPDX-License-Identifier: LGPL-2.1-only
# SPDX-FileCopyrightText: Copyright 2025 Gaël PORTAY

config HAS_LAYER_META_LTS_MIXINS
	bool "meta-lts-mixins (scarthgap/u-boot)"
	depends on IS_BRANCH_SCARTHGAP
	default y if HAS_LAYER_META_RAUC_COMMUNITY_META_RAUC_RASPBERRYPI
	help
	  "Mixin" layer for adding latest Docker versions into the Yocto
	  Project LTS.

config KAS_INCLUDE_HAS_LAYER_META_LTS_MIXINS
	string
	depends on HAS_LAYER_META_LTS_MIXINS
	default "layers/meta-lts-mixins/meta-lts-mixins.yaml"
```
