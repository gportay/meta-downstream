## Kconfig
```kconfig
# SPDX-License-Identifier: LGPL-2.1-only AND CC-BY-SA-2.0-UK
# SPDX-FileCopyrightText: Copyright 2024-2026 Gaël PORTAY
# SPDX-FileCopyrightText: The OpenEmbedded Contributors
#
# The help texts are stolen from the Yocto Project Reference Manual.
#
# https://docs.yoctoproject.org/bitbake/dev/bitbake-user-manual/bitbake-user-manual-ref-variables.html#term-BB_HASHSERVE_DB_DIR
# https://docs.yoctoproject.org/dev/ref-manual/variables.html#term-BB_NO_NETWORK

config KAS_INCLUDE_MAIN
	string
	default "kas-project.yaml"

menu "General"
source "branches/Kconfig"
source "layers/Kconfig"
source "inherits/Kconfig"

config HAS_BB_HASHSERVE_DB_DIR
	bool "Use sstate to share multiple build directories"
	help
	  When BB_HASHSERVE is set to auto, bitbake will use a private
	  location inside a particular build directory for the sqlite
	  database file that holds hash equivalency data.

	  This variable allows using a different path, which can be
	  shared between multiple build directories and bitbake
	  instances that operate on them. This enables using a common
	  ${SSTATE_DIR} together with common hash equivalency data for
	  local builds, without having to separately manage a hash
	  equivalency server.

	  Note

	  This variable cannot be set to a NFS mount and bitbake will
	  error out then. The reason is that NFS implementations can
	  have file locking issues, which can cause data loss and
	  corruption when there are multiple writers operating on a file
	  at the same time as explained in
	  https://sqlite.org/faq.html#q5

	  https://docs.yoctoproject.org/bitbake/dev/bitbake-user-manual/bitbake-user-manual-ref-variables.html#term-BB_HASHSERVE_DB_DIR

config KAS_INCLUDE_HAS_BB_HASHSERVE_DB_DIR
	string
	depends on HAS_BB_HASHSERVE_DB_DIR
	default "bb-hashserve-db-dir.yaml"

config HAS_BB_NO_NETWORK
	bool "No network"
	help
	  Disables network access in the BitBake fetcher modules. With
	  this access disabled, any command that attempts to access the
	  network becomes an error.

	  Disabling network access is useful for testing source mirrors,
	  running builds when not connected to the Internet, and when
	  operating in certain kinds of firewall environments.

	  https://docs.yoctoproject.org/dev/ref-manual/variables.html#term-BB_NO_NETWORK

config KAS_INCLUDE_HAS_BB_NO_NETWORK
	string
	depends on HAS_BB_NO_NETWORK
	default "bb-no-network.yaml"

endmenu

menu "Hardware"
source "machines/Kconfig"
endmenu

menu "System"
source "distros/Kconfig"
source "init-manager/Kconfig"
source "distro-features/Kconfig"
source "kernel/Kconfig"
source "efi-provider/Kconfig"
endmenu

menu "Image"
source "image-classes/Kconfig"
source "image-depends/Kconfig"
source "image-features/Kconfig"
source "image-fstypes/Kconfig"
source "image-installs/Kconfig"
endmenu

menu "Quirks"
	depends on IS_BRANCH_SCARTHGAP || \
		   (IS_BRANCH_MASTER && HAS_LAYER_META_CORAL)
source "quirks/Kconfig"
endmenu
```

## Kconfig.new
```kconfig
# SPDX-License-Identifier: MIT
# SPDX-FileCopyrightText: Copyright 2026 Rtone
# SPDX-FileCopyrightText: Siemens and contributors
# SPDX-FileCopyrightText: The OpenEmbedded Contributors
#
# The help texts are stolen from the kas documentation and the Yocto Project
# Reference Manual.
#
# https://kas.readthedocs.io/en/latest/userguide/plugins.html#module-kas.plugins.dump
# https://docs.yoctoproject.org/dev/ref-manual/classes.html#rm-work

config KAS_INCLUDE_MAIN
	string
	default "kas-project.yaml"

config HAS_INHERIT_RM_WORK
	bool "Inherit rm_work"
	default n
	help
	  The rm_work class supports deletion of temporary workspace,
	  which can ease your hard drive demands during builds.

	  The OpenEmbedded build system can use a substantial amount of
	  disk space during the build process. A portion of this space
	  is the work files under the ${TMPDIR}/work directory for each
	  recipe. Once the build system generates the packages for a
	  recipe, the work files for that recipe are no longer needed.
	  However, by default, the build system preserves these files
	  for inspection and possible debugging purposes. If you would
	  rather have these files deleted to save disk space as the
	  build progresses, you can enable rm_work.

	  https://docs.yoctoproject.org/ref-manual/classes.html#rm-work

config KAS_INCLUDE_HAS_INHERIT_RM_WORK
	string
	depends on HAS_INHERIT_RM_WORK
	default "rm_work.yaml"

config HAS_USE_OVERRIDES_LOCKFILE
	bool "Use lockfile"
	default y
	help
	  Use lockfile with exact SHAs.

	  The lockfile contains the exact commit of each repository. It
	  is used to pin the commit of floating branches and tags.

config KAS_INCLUDE_HAS_OVERRIDES_LOCKFILE
	string
	depends on HAS_USE_OVERRIDES_LOCKFILE
	default "overrides-lockfile.yaml"
```

## branches/Kconfig
```kconfig
# SPDX-License-Identifier: LGPL-2.1-only
# SPDX-FileCopyrightText: Copyright 2024 Gaël PORTAY
#
# See the Yocto Project Reference Manual.
#
# https://docs.yoctoproject.org/dev/ref-manual/release-process.html
# https://www.yoctoproject.org/development/releases/

choice
	prompt "Branch"
	default IS_BRANCH_MASTER
	help
	  https://wiki.yoctoproject.org/wiki/Releases

config IS_BRANCH_KIRKSTONE
	bool "Kirkstone (4.0, LTS)"
	help
	  https://downloads.yoctoproject.org/releases/yocto/yocto-4.0/RELEASENOTES

config IS_BRANCH_SCARTHGAP
	bool "Scarthgap (5.0, LTS)"
	help
	  https://downloads.yoctoproject.org/releases/yocto/yocto-5.0/RELEASENOTES

config IS_BRANCH_STYHEAD
	bool "Styhead (5.1)"
	help
	  https://downloads.yoctoproject.org/releases/yocto/yocto-5.1/RELEASENOTES

config IS_BRANCH_MASTER
	bool "master"
	help
	  https://docs.yoctoproject.org/dev/_images/releases.svg

endchoice

config KAS_INCLUDE_IS_BRANCH
	string
	default "branches/kirkstone.yaml" if IS_BRANCH_KIRKSTONE
	default "branches/scarthgap.yaml" if IS_BRANCH_SCARTHGAP
	default "branches/styhead.yaml" if IS_BRANCH_STYHEAD
	default "branches/master.yaml"
```

## distro-features/Kconfig
```kconfig
# SPDX-License-Identifier: LGPL-2.1-only AND CC-BY-SA-2.0-UK
# SPDX-FileCopyrightText: Copyright 2024 Gaël PORTAY
# SPDX-FileCopyrightText: The OpenEmbedded Contributors
#
# The help texts are stolen from the Yocto Project Reference Manual.
#
# https://docs.yoctoproject.org/dev/ref-manual/index.html
# https://docs.yoctoproject.org/dev/ref-manual/features.html

menu "Distro Features"

config HAS_DISTRO_FEATURE_SYSTEMD
	bool "Enable systemd"
	default y
	help
	  Include support for this init manager, which is a full
	  replacement of for init with parallel starting of services,
	  reduced shell overhead, and other features. This init manager
	  is used by many distributions.

config KAS_INCLUDE_HAS_DISTRO_FEATURE_SYSTEMD
	string
	depends on HAS_DISTRO_FEATURE_SYSTEMD
	default "distro-features/systemd.yaml"

config HAS_DISTRO_FEATURE_USRMERGE
	bool "Enable usrmerge"
	default y
	help
	  Merges the /bin, /sbin, /lib, and /lib64 directories into
	  their respective counterparts in the /usr directory to provide
	  better package and application compatibility.

config KAS_INCLUDE_HAS_DISTRO_FEATURE_USRMERGE
	string
	depends on HAS_DISTRO_FEATURE_USRMERGE
	default "distro-features/usrmerge.yaml"

config HAS_DISTRO_FEATURE_PAM
	bool "Enable PAM"

config KAS_INCLUDE_HAS_DISTRO_FEATURE_PAM
	string
	depends on HAS_DISTRO_FEATURE_PAM
	default "distro-features/pam.yaml"

config HAS_DISTRO_FEATURE_RAUC
	bool "Enable RAUC"
	select HAS_IMAGE_INSTALL_RAUC
	help
	  Safe and secure software updates for embedded Linux.

	  https://rauc.io/

config KAS_INCLUDE_HAS_DISTRO_FEATURE_RAUC
	string
	depends on HAS_DISTRO_FEATURE_RAUC
	default "distro-features/rauc.yaml"

config HAS_DISTRO_FEATURE_SECURITY
	bool "Enable security"

config KAS_INCLUDE_HAS_DISTRO_FEATURE_SECURITY
	string
	depends on HAS_DISTRO_FEATURE_SECURITY
	default "distro-features/security.yaml"

endmenu
```

## distros/Kconfig
```kconfig
# SPDX-License-Identifier: LGPL-2.1-only
# SPDX-FileCopyrightText: Copyright 2025-2026 Gaël PORTAY

choice
	prompt "Distro"
	default IS_DISTRO_POKY if IS_BRANCH_SCARTHGAP
	default IS_DISTRO_NODISTRO

config IS_DISTRO_NODISTRO
	bool "nodistro"
	help
	  https://git.openembedded.org/openembedded-core/

config IS_DISTRO_POKY
	bool "poky"
	select HAS_LAYER_META_YOCTO if IS_OPENEMBEDDED_CORE_OPENEMBEDDED_CORE
	select HAS_LAYER_META_YOCTO_META_POKY if IS_OPENEMBEDDED_CORE_OPENEMBEDDED_CORE
	select HAS_LAYER_POKY if IS_OPENEMBEDDED_CORE_POKY
	select HAS_LAYER_POKY_META_POKY if IS_OPENEMBEDDED_CORE_POKY
	help
	  https://git.yoctoproject.org/meta-yocto/tree/meta-poky/conf/distro/poky.conf

config IS_DISTRO_POKY_ALTCFG
	bool "poky-altcfg"
	select HAS_LAYER_META_YOCTO if IS_OPENEMBEDDED_CORE_OPENEMBEDDED_CORE
	select HAS_LAYER_META_YOCTO_META_POKY if IS_OPENEMBEDDED_CORE_OPENEMBEDDED_CORE
	select HAS_LAYER_POKY if IS_OPENEMBEDDED_CORE_POKY
	select HAS_LAYER_POKY_META_POKY if IS_OPENEMBEDDED_CORE_POKY
	help
	  https://git.yoctoproject.org/meta-yocto/tree/meta-poky/conf/distro/poky-altcfg.conf

config IS_DISTRO_POKY_BLEEDING
	bool "poky-bleeding"
	select HAS_LAYER_META_YOCTO if IS_OPENEMBEDDED_CORE_OPENEMBEDDED_CORE
	select HAS_LAYER_META_YOCTO_META_POKY if IS_OPENEMBEDDED_CORE_OPENEMBEDDED_CORE
	select HAS_LAYER_POKY if IS_OPENEMBEDDED_CORE_POKY
	select HAS_LAYER_POKY_META_POKY if IS_OPENEMBEDDED_CORE_POKY
	help
	  https://git.yoctoproject.org/meta-yocto/tree/meta-poky/conf/distro/poky-bleeding.conf

config IS_DISTRO_POKY_TINY
	bool "poky-tiny"
	select HAS_LAYER_META_YOCTO if IS_OPENEMBEDDED_CORE_OPENEMBEDDED_CORE
	select HAS_LAYER_META_YOCTO_META_POKY if IS_OPENEMBEDDED_CORE_OPENEMBEDDED_CORE
	select HAS_LAYER_POKY if IS_OPENEMBEDDED_CORE_POKY
	select HAS_LAYER_POKY_META_POKY if IS_OPENEMBEDDED_CORE_POKY
	help
	  https://git.yoctoproject.org/meta-yocto/tree/meta-poky/conf/distro/poky-tiny.conf

endchoice

config KAS_INCLUDE_IS_DISTRO
	string
	default "distros/nodistro.yaml" if IS_DISTRO_NODISTRO
	default "distros/poky.yaml" if IS_DISTRO_POKY
	default "distros/poky-altcfg.yaml" if IS_DISTRO_POKY_ALTCFG
	default "distros/poky-bleeding.yaml" if IS_DISTRO_POKY_BLEEDING
	default "distros/poky-tiny.yaml" if IS_DISTRO_POKY_TINY
	default ""
```

## downstream-features/Kconfig
```kconfig
# SPDX-License-Identifier: LGPL-2.1-only
# SPDX-FileCopyrightText: Copyright 2024 Gaël PORTAY

config BLKPG_PART
	bool "blkpg-part"
	default n

config KAS_INCLUDE_BLKPG_PART
        string
        default "downstream-features/blkpg-part.yaml" if BLKPG_PART

config SSSD
	bool "sssd"
	default n

config KAS_INCLUDE_SSSD
        string
        default "downstream-features/sssd.yaml"
```

## efi-provider/Kconfig
```kconfig
# SPDX-License-Identifier: LGPL-2.1-only AND CC-BY-SA-2.0-UK
# SPDX-FileCopyrightText: Copyright 2026 Gaël PORTAY
# SPDX-FileCopyrightText: The OpenEmbedded Contributors
#
# The help texts are stolen from the Yocto Project Reference Manual.
#
# https://docs.yoctoproject.org/ref-manual/variables.html#term-EFI_PROVIDER

menu "EFI Provider"
	depends on HAS_IMAGE_FSTYPES_WIC

choice
	prompt "Default EFI Provider"
	default IS_EFI_PROVIDER_SYSTEMD_BOOT if IS_MACHINE_QEMUX86_64 || HAS_IMAGE_CLASSES_DM_VERITY_IMG
	default IS_EFI_PROVIDER_GRUB_EFI if IS_MACHINE_QEMUARM64
	help
	  When building bootable images (i.e. where hddimg, iso, or
	  wic.vmdk is in IMAGE_FSTYPES), the EFI_PROVIDER variable
	  specifies the EFI bootloader to use. The default is
	  “grub-efi”, but “systemd-boot” can be used instead.

	  https://docs.yoctoproject.org/ref-manual/variables.html#term-EFI_PROVIDER

config IS_EFI_PROVIDER_GRUB_EFI
	bool "grub-efi"
	help
	  The grub-efi class provides grub-efi-specific functions for
	  building bootable images.

	  https://docs.yoctoproject.org/ref-manual/classes.html#grub-efi

config IS_EFI_PROVIDER_SYSTEMD_BOOT
	bool "systemd-boot"
	help
	  The systemd-boot class provides functions specific to the
	  systemd-boot bootloader for building bootable images. This is
	  an internal class and is not intended to be used directly.

	  https://docs.yoctoproject.org/ref-manual/classes.html#systemd-boot

endchoice

config KAS_INCLUDE_IS_EFI_PROVIDER_GRUB_EFI
	string
	depends on IS_EFI_PROVIDER_GRUB_EFI
	default "efi-provider/grub-efi.yaml"

config KAS_INCLUDE_IS_EFI_PROVIDER_SYSTEMD_BOOT
	string
	depends on IS_EFI_PROVIDER_SYSTEMD_BOOT
	default "efi-provider/systemd-boot.yaml"

endmenu
```

## features/Kconfig
```kconfig
# SPDX-License-Identifier: LGPL-2.1-only AND CC-BY-SA-2.0-UK
# SPDX-FileCopyrightText: Copyright 2024 Gaël PORTAY
# SPDX-FileCopyrightText: The OpenEmbedded Contributors
#
# The help texts are stolen from the Yocto Project Reference Manual.
#
# https://docs.yoctoproject.org/dev/ref-manual/index.html
# https://docs.yoctoproject.org/dev/ref-manual/features.html

config HAS_FEATURE_DEBUG_TWEAKS
	bool
	prompt "Enable debug-tweaks"
	select HAS_FEATURE_ALLOW_EMPTY_PASSWORD
	select HAS_FEATURE_EMPTY_ROOT_PASSWORD
	select HAS_FEATURE_ALLOW_ROOT_LOGIN
	select HAS_FEATURE_POST_INSTALL_LOGGING
	default y
	help
	  Makes an image suitable for development (e.g. allows root
	  logins, logins without passwords —including root ones, and
	  enables post-installation logging). See the
	  allow-empty-password, allow-root-login, empty-root-password,
	  and post-install-logging features in this list for additional
	  information.

config HAS_FEATURE_ALLOW_EMPTY_PASSWORD
	bool
	prompt "Enable allow-empty-password"
	default y
	help
	  Allows Dropbear and OpenSSH to accept logins from accounts
	  having an empty password string.

config KAS_INCLUDE_FEATURE_ALLOW_EMPTY_PASSWORD
	string
	default "features/allow-empty-password.yaml" \
		if HAS_FEATURE_ALLOW_EMPTY_PASSWORD
	default ""

config HAS_FEATURE_EMPTY_ROOT_PASSWORD
	bool
	prompt "Enable empty-root-password"
	default y
	help
	  This feature or debug-tweaks is required if you want to allow
	  root login with an empty password. If these features are not
	  present in IMAGE_FEATURES, a non-empty password is forced in
	  /etc/passwd and /etc/shadow if such files exist.

	  Note: empty-root-password doesn’t set an empty root password
	  by itself. You get an initial empty root password thanks to
	  the base-passwd and shadow recipes, and the presence of
	  empty-root-password or debug-tweaks just disables the
	  mechanism which forces an non-empty password for the root
	  user.

config KAS_INCLUDE_FEATURE_EMPTY_ROOT_PASSWORD
	string
	default "features/empty-root-password.yaml" \
		if HAS_FEATURE_EMPTY_ROOT_PASSWORD
	default ""

config HAS_FEATURE_ALLOW_ROOT_LOGIN
	bool
	prompt "Enable allow-root-login"
	default y
	help
	  Allows Dropbear and OpenSSH to accept root logins.

config KAS_INCLUDE_FEATURE_ALLOW_ROOT_LOGIN
	string
	default "features/allow-root-login.yaml" \
		if HAS_FEATURE_ALLOW_ROOT_LOGIN
	default ""

config HAS_FEATURE_POST_INSTALL_LOGGING
	bool
	prompt "Enable post-install-logging"
	default y

config KAS_INCLUDE_FEATURE_POST_INSTALL_LOGGING
	string
	default "features/post-install-logging.yaml" \
		if HAS_FEATURE_POST_INSTALL_LOGGING
	default ""
```
