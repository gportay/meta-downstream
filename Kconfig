## image-classes/qemuboot/Kconfig
```kconfig
# SPDX-License-Identifier: LGPL-2.1-only AND CC-BY-SA-2.0-UK
# SPDX-FileCopyrightText: Copyright 2024 Gaël PORTAY
# SPDX-FileCopyrightText: The OpenEmbedded Contributors
#
# The help texts are stolen from the Yocto Sources.
#
# https://git.yoctoproject.org/poky/plain/meta/classes-recipe/qemuboot.bbclass

menu "QEMU Boot"
	depends on IS_QEMU || HAS_IMAGE_CLASSES_QEMUBOOT

choice
	prompt "Default FileSystem Type"
	default IS_IMAGE_CLASSES_QEMUBOOT_QB_DEFAULT_FSTYPE_EXT4
	help
	  QB_DEFAULT_FSTYPE: default FSTYPE to boot, e.g., "ext4"

config IS_IMAGE_CLASSES_QEMUBOOT_QB_DEFAULT_FSTYPE_EXT4
	bool "ext4"
	select HAS_IMAGE_FSTYPES_EXT4

config IS_IMAGE_CLASSES_QEMUBOOT_QB_DEFAULT_FSTYPE_WIC
	bool "wic"
	select HAS_IMAGE_FSTYPES_WIC

endchoice

config KAS_INCLUDE_IS_IMAGE_CLASSES_QEMUBOOT_QB_DEFAULT_FSTYPE_EXT4
	string
	depends on IS_IMAGE_CLASSES_QEMUBOOT_QB_DEFAULT_FSTYPE_EXT4
	default "image-classes/qemuboot/default-fstype-ext4.yaml"

config KAS_INCLUDE_IS_IMAGE_CLASSES_QEMUBOOT_QB_DEFAULT_FSTYPE_WIC
	string
	depends on IS_IMAGE_CLASSES_QEMUBOOT_QB_DEFAULT_FSTYPE_WIC
	default "image-classes/qemuboot/default-fstype-wic.yaml"

endmenu
```

## image-depends/Kconfig
```kconfig
# SPDX-License-Identifier: LGPL-2.1-only
# SPDX-FileCopyrightText: Copyright 2024 Gaël PORTAY

menu "Image Depends"

config HAS_IMAGE_DEPEND_EDK2_FIRMWARE
	bool "Depend EDK II"
	select HAS_LAYER_META_ARM
	select HAS_LAYER_META_ARM_META_ARM
	help
	  EDK II is a modern, feature-rich, cross-platform firmware
	  development environment for the UEFI and PI specifications.
	  EDK II is open source, using a BSD+Patent.

	  https://github.com/tianocore/tianocore.github.io/wiki/edk-ii

config KAS_INCLUDE_HAS_IMAGE_DEPEND_EDK2_FIRMWARE
	string
	depends on HAS_IMAGE_DEPEND_EDK2_FIRMWARE
	default "image-depends/edk2-firmware.yaml"

config HAS_IMAGE_DEPEND_OVMF
	bool "Depend OVMF"
	select HAS_LAYER_POKY
	select HAS_LAYER_POKY_META
	help
	  OVMF is an EDK II based project to enable UEFI support for
	  Virtual Machines. OVMF contains sample UEFI firmware for QEMU
	  and KVM.

	  https://github.com/tianocore/tianocore.github.io/wiki/OVMF

config KAS_INCLUDE_HAS_IMAGE_DEPEND_OVMF
	string
	depends on HAS_IMAGE_DEPEND_OVMF
	default "image-depends/ovmf.yaml"

endmenu
```

## image-features/Kconfig
```kconfig
# SPDX-License-Identifier: LGPL-2.1-only AND CC-BY-SA-2.0-UK
# SPDX-FileCopyrightText: Copyright 2024 Gaël PORTAY
# SPDX-FileCopyrightText: The OpenEmbedded Contributors
#
# The help texts are stolen from the Yocto Project Reference Manual.
#
# https://docs.yoctoproject.org/dev/ref-manual/index.html
# https://docs.yoctoproject.org/dev/ref-manual/features.html

menu "Image Features"

choice
	prompt "Enable ssh-server"
	default IS_IMAGE_FEATURE_SSH_SERVER_NONE

config IS_IMAGE_FEATURE_SSH_SERVER_NONE
	bool "none"

config IS_IMAGE_FEATURE_SSH_SERVER_DROPBEAR
	bool "Dropbear"
	help
	  Installs the Dropbear minimal SSH server.

	  https://matt.ucc.asn.au/dropbear/dropbear.html

config IS_IMAGE_FEATURE_SSH_SERVER_OPENSSH
	bool "OpenSSH"
	help
	  Installs the OpenSSH SSH server, which is more full-featured
	  than Dropbear. Note that if both the OpenSSH SSH server and
	  the Dropbear minimal SSH server are present in IMAGE_FEATURES,
	  then OpenSSH will take precedence and Dropbear will not be
	  installed.

	  https://www.openssh.com/

endchoice

config KAS_INCLUDE_IS_IMAGE_FEATURE_SSH_SERVER_DROPBEAR
	string
	depends on IS_IMAGE_FEATURE_SSH_SERVER_DROPBEAR
	default "image-features/ssh-server-dropbear.yaml"

config HAS_IMAGE_FEATURE_SSH_SERVER_DROPBEAR_OPENSSH_SFTP_SERVER
	bool "Install openssh-sftp-server"
	depends on IS_IMAGE_FEATURE_SSH_SERVER_DROPBEAR
	default y
	help
	  As of the 4.1 release, the ssh-server-dropbear feature also
	  recommends the openssh-sftp-server package, which by default
	  will be pulled into the image. This is because recent versions
	  of the OpenSSH scp client now use the SFTP protocol, and thus
	  require an SFTP server to be present to connect to.

config KAS_INCLUDE_HAS_IMAGE_FEATURE_SSH_SERVER_DROPBEAR_OPENSSH_SFTP_SERVER
	string
	depends on HAS_IMAGE_FEATURE_SSH_SERVER_DROPBEAR_OPENSSH_SFTP_SERVER
	default "image-features/ssh-server-dropbear+openssh-sftp-server.yaml" \
		if IS_BRANCH_KIRKSTONE && HAS_IMAGE_FEATURE_SSH_SERVER_DROPBEAR_OPENSSH_SFTP_SERVER
	default "image-features/ssh-server-dropbear-openssh-sftp-server.yaml" \
		if !IS_BRANCH_KIRKSTONE && !HAS_IMAGE_FEATURE_SSH_SERVER_DROPBEAR_OPENSSH_SFTP_SERVER
	default ""

config KAS_INCLUDE_IS_IMAGE_FEATURE_SSH_SERVER_OPENSSH
	string
	depends on IS_IMAGE_FEATURE_SSH_SERVER_OPENSSH
	default "image-features/ssh-server-openssh.yaml"

config HAS_IMAGE_FEATURE_DEBUG_TWEAKS
	bool "Enable debug-tweaks"
	depends on IS_BRANCH_KIRKSTONE || \
		   IS_BRANCH_SCARTHGAP || \
		   IS_BRANCH_STYHEAD
	select HAS_IMAGE_FEATURE_ALLOW_EMPTY_PASSWORD
	select HAS_IMAGE_FEATURE_EMPTY_ROOT_PASSWORD
	select HAS_IMAGE_FEATURE_ALLOW_ROOT_LOGIN
	select HAS_IMAGE_FEATURE_POST_INSTALL_LOGGING
	default y
	help
	  Makes an image suitable for development (e.g. allows root
	  logins, logins without passwords —including root ones, and
	  enables post-installation logging). See the
	  allow-empty-password, allow-root-login, empty-root-password,
	  and post-install-logging features in this list for additional
	  information.

config HAS_IMAGE_FEATURE_ALLOW_EMPTY_PASSWORD
	bool "Enable allow-empty-password"
	default y
	help
	  Allows Dropbear and OpenSSH to accept logins from accounts
	  having an empty password string.


config KAS_INCLUDE_HAS_IMAGE_FEATURE_ALLOW_EMPTY_PASSWORD
	string
	depends on HAS_IMAGE_FEATURE_ALLOW_EMPTY_PASSWORD
	default "image-features/allow-empty-password.yaml"

config HAS_IMAGE_FEATURE_EMPTY_ROOT_PASSWORD
	bool "Enable empty-root-password"
	default y
	help
	  This feature or debug-tweaks is required if you want to allow
	  root login with an empty password. If these features are not
	  present in IMAGE_IMAGE_FEATURES, a non-empty password is forced in
	  /etc/passwd and /etc/shadow if such files exist.

	  Note: empty-root-password doesn’t set an empty root password
	  by itself. You get an initial empty root password thanks to
	  the base-passwd and shadow recipes, and the presence of
	  empty-root-password or debug-tweaks just disables the
	  mechanism which forces an non-empty password for the root
	  user.

config KAS_INCLUDE_HAS_IMAGE_FEATURE_EMPTY_ROOT_PASSWORD
	string
	depends on HAS_IMAGE_FEATURE_EMPTY_ROOT_PASSWORD
	default "image-features/empty-root-password.yaml"

config HAS_IMAGE_FEATURE_ALLOW_ROOT_LOGIN
	bool "Enable allow-root-login"
	default y
	help
	  Allows Dropbear and OpenSSH to accept root logins.

config KAS_INCLUDE_HAS_IMAGE_FEATURE_ALLOW_ROOT_LOGIN
	string
	depends on HAS_IMAGE_FEATURE_ALLOW_ROOT_LOGIN
	default "image-features/allow-root-login.yaml"

config HAS_IMAGE_FEATURE_POST_INSTALL_LOGGING
	bool "Enable post-install-logging"
	default y

config KAS_INCLUDE_HAS_IMAGE_FEATURE_POST_INSTALL_LOGGING
	string
	depends on HAS_IMAGE_FEATURE_POST_INSTALL_LOGGING
	default "image-features/post-install-logging.yaml"

endmenu
```

## image-installs/Kconfig
```kconfig
# SPDX-License-Identifier: LGPL-2.1-only
# SPDX-FileCopyrightText: Copyright 2024-2025 Gaël PORTAY

menu "Image Installs"

config HAS_IMAGE_INSTALL_BLKPG_PART
	bool "Install blkpg-part"
	select HAS_LAYER_THIS
	select HAS_LAYER_THIS_META_BLKPG_PART
	help
	  Partition table and disk geometry handling utility.

	  https://github.com/gportay/blkpg-part

config KAS_INCLUDE_HAS_IMAGE_INSTALL_BLKPG_PART
	string
	depends on HAS_IMAGE_INSTALL_BLKPG_PART
	default "image-installs/blkpg-part.yaml"

config HAS_IMAGE_INSTALL_GRUB_EFI
	bool "Install GNU GRUB (EFI)"
	select HAS_LAYER_POKY
	select HAS_LAYER_POKY_META
	help
	  GNU GRUB is a Multiboot boot loader. It was derived from GRUB,
	  the GRand Unified Bootloader, which was originally designed
	  and implemented by Erich Stefan Boleyn.

	  Briefly, a boot loader is the first software program that runs
	  when a computer starts. It is responsible for loading and
	  transferring control to the operating system kernel software
	  (such as the Hurd or Linux). The kernel, in turn, initializes
	  the rest of the operating system (e.g. GNU).

	  https://www.gnu.org/software/grub/

config KAS_INCLUDE_HAS_IMAGE_INSTALL_GRUB_EFI
	string
	depends on HAS_IMAGE_INSTALL_GRUB_EFI
	default "image-installs/grub-efi.yaml"

config HAS_IMAGE_INSTALL_RAUC
	bool "Install RAUC"
	select HAS_LAYER_META_RAUC
	help
	  Safe and secure software updates for embedded Linux.

	  https://rauc.io/

config KAS_INCLUDE_HAS_IMAGE_INSTALL_RAUC
	string
	depends on HAS_IMAGE_INSTALL_RAUC
	default "image-installs/rauc.yaml"

if HAS_IMAGE_INSTALL_RAUC

config HAS_IMAGE_INSTALL_RASPBERRYPI_FIRMWARE_RAUC_BOOTLOADER_BACKEND
	bool "Install raspberrypi-firmware-rauc-bootloader-backend"
	depends on IS_RASPBERRYPI
	depends on IS_RASPBERRYPI_BOOTLOADER_RASPBERRYPI_FIRMWARE
	select HAS_RASPBERRYPI_FIRMWARE_USE_AUTOBOOT_TXT
	select HAS_IMAGE_INSTALL_RASPBERRYPI_FIRMWARE_SYSTEMD_GENERATOR
	select HAS_IMAGE_INSTALL_RPI_AUTOBOOT
	select HAS_LAYER_THIS
	select HAS_LAYER_THIS_META_RAUC_RASPBERRYPI_FIRMWARE
	default y
	help
	  An implementation of a RAUC custom bootloader backend for the
	  Raspberry Pi firmware.

	  https://github.com/Rtone/raspberrypi-firmware-rauc-bootloader-backend

config KAS_INCLUDE_HAS_IMAGE_INSTALL_RASPBERRYPI_FIRMWARE_RAUC_BOOTLOADER_BACKEND
	string
	depends on HAS_IMAGE_INSTALL_RASPBERRYPI_FIRMWARE_RAUC_BOOTLOADER_BACKEND
	default "image-installs/raspberrypi-firmware-rauc-bootloader-backend.yaml"

config HAS_IMAGE_INSTALL_RAUC_RASPBERRYPI
	bool
	depends on IS_MACHINE_RASPBERRYPI3_64 || \
		   IS_MACHINE_RASPBERRYPI4_64
	depends on IS_RASPBERRYPI_BOOTLOADER_U_BOOT
	select HAS_LAYER_META_RAUC_COMMUNITY
	select HAS_LAYER_META_RAUC_COMMUNITY_META_RAUC_RASPBERRYPI
	default y

config KAS_INCLUDE_HAS_IMAGE_INSTALL_RAUC_RASPBERRYPI
	string
	depends on HAS_IMAGE_INSTALL_RAUC_RASPBERRYPI
	default "image-installs/rauc-raspberrypi.yaml"

config HAS_IMAGE_INSTALL_RAUC_QEMUX86
	bool
	depends on IS_MACHINE_QEMUX86_64
	depends on HAS_QEMUALL_USE_WIC
	select HAS_LAYER_META_RAUC_COMMUNITY
	select HAS_LAYER_META_RAUC_COMMUNITY_META_RAUC_QEMUX86
	select HAS_LAYER_THIS
	select HAS_LAYER_THIS_META_DOWNSTREAM
	select HAS_IMAGE_DEPEND_OVMF
	default y

config KAS_INCLUDE_HAS_IMAGE_INSTALL_RAUC_QEMUX86
	string
	depends on HAS_IMAGE_INSTALL_RAUC_QEMUX86
	default "image-installs/rauc-qemux86.yaml"

endif # HAS_IMAGE_INSTALL_RAUC

config HAS_IMAGE_INSTALL_SSSD
	bool "Install SSSD"
	select HAS_LAYER_META_OPENEMBEDDED
	select HAS_LAYER_META_OPENEMBEDDED_META_OE
	select HAS_LAYER_META_OPENEMBEDDED_META_NETWORKING
	select HAS_LAYER_META_SECURITY
	select HAS_DISTRO_FEATURE_PAM
	select HAS_DISTRO_FEATURE_SECURITY
	help
	  A daemon to manage identity, authentication and authorization
	  for centrally-managed systems.

	  https://sssd.io/

config KAS_INCLUDE_HAS_IMAGE_INSTALL_SSSD
	string
	depends on HAS_IMAGE_INSTALL_SSSD
	default "image-installs/sssd.yaml"

config HAS_IMAGE_INSTALL_SSSD_PYTHON3_BINDINGS
	bool "python3-bindings"
	depends on HAS_IMAGE_INSTALL_SSSD
	select HAS_LAYER_META_OPENEMBEDDED_META_PYTHON

config KAS_INCLUDE_HAS_IMAGE_INSTALL_SSSD_PYTHON3_BINDINGS
	string
	depends on HAS_IMAGE_INSTALL_SSSD_PYTHON3_BINDINGS
	default "image-installs/sssd-python3-bindings.yaml"

config HAS_IMAGE_INSTALL_RASPBERRYPI_FIRMWARE_SYSTEMD_GENERATOR
	bool "Install raspberrypi-firmware-systemd-generator"
	depends on HAS_DISTRO_FEATURE_SYSTEMD
	depends on IS_RASPBERRYPI
	depends on IS_RASPBERRYPI_BOOTLOADER_RASPBERRYPI_FIRMWARE
	select HAS_RASPBERRYPI_FIRMWARE_USE_AUTOBOOT_TXT
	select HAS_LAYER_META_RAUC_COMMUNITY
	select HAS_LAYER_META_RAUC_COMMUNITY_META_RAUC_RASPBERRYPI
	select HAS_LAYER_THIS
	select HAS_LAYER_THIS_META_RAUC_RASPBERRYPI_FIRMWARE
	help
	  A systemd-generator for mounting the bootloader partitions of
	  the Raspberry Pi firmware.

	  https://github.com/Rtone/raspberrypi-firmware-systemd-generator

config KAS_INCLUDE_HAS_IMAGE_INSTALL_RASPBERRYPI_FIRMWARE_SYSTEMD_GENERATOR
	string
	depends on HAS_IMAGE_INSTALL_RASPBERRYPI_FIRMWARE_SYSTEMD_GENERATOR
	default "image-installs/raspberrypi-firmware-systemd-generator.yaml"

config HAS_IMAGE_INSTALL_GSTREAMER1_0_META_BASE
	bool "Install gstreamer1.0-meta-base"
	select HAS_LAYER_POKY_META
	select HAS_LAYER_META_OPENEMBEDDED
	select HAS_LAYER_META_OPENEMBEDDED_META_OE
	select HAS_LAYER_META_OPENEMBEDDED_META_PYTHON
	select HAS_LAYER_META_OPENEMBEDDED_META_MULTIMEDIA

config KAS_INCLUDE_HAS_IMAGE_INSTALL_GSTREAMER1_0_META_BASE
	string
	depends on HAS_IMAGE_INSTALL_GSTREAMER1_0_META_BASE
	default "image-installs/gstreamer1.0-meta-base.yaml"

config HAS_IMAGE_INSTALL_GSTREAMER1_0_PLUGINS_BAD
	bool "streamer1.0-plugins-bad"
	depends on HAS_IMAGE_INSTALL_GSTREAMER1_0_META_BASE
	help
	  THE BAD
	  --- "That an accusation?"

	  No perfectly groomed moustache or any amount of fine clothing
	  is going to cover up the truth - these plug-ins are Bad with
	  a capital B. They look fine on the outside, and might even
	  appear to get the job done, but at the end of the day they're
	  a black sheep. Without a golden-haired angel to watch over
	  them, they'll probably land in an unmarked grave at the final
	  showdown.

	  Don't bug us about their quality - exercise your Free
	  Software rights, patch up the offender and send us the patch
	  on the fastest steed you can steal from the Confederates.
	  Because you see, in this world, there's two kinds of people,
	  my friend: those with loaded guns and those who dig. You dig.

	  https://gitlab.freedesktop.org/gstreamer/gstreamer/-/tree/main/subprojects/gst-plugins-bad

config KAS_INCLUDE_HAS_IMAGE_INSTALL_GSTREAMER1_0_PLUGINS_BAD
	string
	depends on HAS_IMAGE_INSTALL_GSTREAMER1_0_PLUGINS_BAD
	default "image-installs/gstreamer1.0-plugins-bad.yaml"

config HAS_IMAGE_INSTALL_GSTREAMER1_0_PLUGINS_UGLY
	bool "streamer1.0-plugins-ugly"
	depends on HAS_IMAGE_INSTALL_GSTREAMER1_0_META_BASE
	help
	  THE UGLY

	  --- "When you have to shoot, shoot. Don't talk."

	  There are times when the world needs a color between black
	  and white. Quality code to match the good's, but two-timing,
	  backstabbing and ready to sell your freedom down the river.
	  These plug-ins might have a patent noose around their neck,
	  or a lock-up license, or any other problem that makes you
	  think twice about shipping them.

	  We don't call them ugly because we like them less. Does a
	  mother love her son less because he's not as pretty as the
	  other ones ? No - she commends him on his great personality.
	  These plug-ins are the life of the party. And we'll still
	  step in and set them straight if you report any unacceptable
	  behaviour - because there are two kinds of people in the
	  world, my friend: those with a rope around their neck and the
	  people who do the cutting.

	  https://gitlab.freedesktop.org/gstreamer/gstreamer/-/tree/main/subprojects/gst-plugins-ugly

config KAS_INCLUDE_HAS_IMAGE_INSTALL_GSTREAMER1_0_PLUGINS_UGLY
	string
	depends on HAS_IMAGE_INSTALL_GSTREAMER1_0_PLUGINS_UGLY
	default "image-installs/gstreamer1.0-plugins-ugly.yaml"

endmenu
```
