## layers/meta-openembedded/Kconfig
```kconfig
# SPDX-License-Identifier: LGPL-2.1-only
# SPDX-FileCopyrightText: Copyright 2024 Gaël PORTAY

config HAS_LAYER_META_OPENEMBEDDED
	bool "meta-openembedded"
	help
	  Collection of layers for the OE-core universe.

	  https://github.com/openembedded/meta-openembedded

config KAS_INCLUDE_HAS_LAYER_META_OPENEMBEDDED
	string
	depends on HAS_LAYER_META_OPENEMBEDDED
	default "layers/meta-openembedded/meta-openembedded.yaml"

if HAS_LAYER_META_OPENEMBEDDED

config HAS_LAYER_META_OPENEMBEDDED_META_OE
	bool "meta-oe"
	select HAS_LAYER_POKY_META
	help
	  https://github.com/openembedded/meta-openembedded/tree/master/meta-oe

config KAS_INCLUDE_HAS_LAYER_META_OPENEMBEDDED_META_OE
	string
	depends on HAS_LAYER_META_OPENEMBEDDED_META_OE
	default "layers/meta-openembedded/meta-oe.yaml"

config HAS_LAYER_META_OPENEMBEDDED_META_PYTHON
	bool "meta-python"
	select HAS_LAYER_POKY_META
	select HAS_LAYER_META_OPENEMBEDDED_META_OE
	help
	  https://github.com/openembedded/meta-openembedded/tree/master/meta-python

config KAS_INCLUDE_HAS_LAYER_META_OPENEMBEDDED_META_PYTHON
	string
	depends on HAS_LAYER_META_OPENEMBEDDED_META_PYTHON
	default "layers/meta-openembedded/meta-python.yaml"

config HAS_LAYER_META_OPENEMBEDDED_META_NETWORKING
	bool "meta-networking"
	select HAS_LAYER_POKY_META
	select HAS_LAYER_META_OPENEMBEDDED_META_OE
	select HAS_LAYER_META_OPENEMBEDDED_META_PYTHON
	help
	  https://github.com/openembedded/meta-openembedded/tree/master/meta-networking

config KAS_INCLUDE_HAS_LAYER_META_OPENEMBEDDED_META_NETWORKING
	string
	depends on HAS_LAYER_META_OPENEMBEDDED_META_NETWORKING
	default "layers/meta-openembedded/meta-networking.yaml"

config HAS_LAYER_META_OPENEMBEDDED_META_MULTIMEDIA
	bool "meta-multimedia"
	select HAS_LAYER_POKY_META
	select HAS_LAYER_META_OPENEMBEDDED_META_OE
	select HAS_LAYER_META_OPENEMBEDDED_META_PYTHON
	help
	  https://github.com/openembedded/meta-openembedded/tree/master/meta-networking

config KAS_INCLUDE_HAS_LAYER_META_OPENEMBEDDED_META_MULTIMEDIA
	string
	depends on HAS_LAYER_META_OPENEMBEDDED_META_MULTIMEDIA
	default "layers/meta-openembedded/meta-multimedia.yaml"

endif # HAS_LAYER_META_OPENEMBEDDED
```

## layers/meta-raspberrypi/Kconfig
```kconfig
# SPDX-License-Identifier: LGPL-2.1-only
# SPDX-FileCopyrightText: Copyright 2024 Gaël PORTAY

config HAS_LAYER_META_RASPBERRYPI
	bool "meta-raspberrypi"
	help
	  Yocto/OE BSP layer for the Raspberry Pi boards.

config KAS_INCLUDE_LAYER_META_RASPBERRYPI
	string
	depends on HAS_LAYER_META_RASPBERRYPI
	default "layers/meta-raspberrypi/meta-raspberrypi.yaml"
```

## layers/meta-rauc-community/Kconfig
```kconfig
# SPDX-License-Identifier: LGPL-2.1-only
# SPDX-FileCopyrightText: Copyright 2024 Gaël PORTAY

config HAS_LAYER_META_RAUC_COMMUNITY
	bool "meta-rauc-community"
	default y if HAS_DISTRO_FEATURE_RAUC
	help
	  Yocto/OpenEmbedded meta layer with examples for integration of
	  RAUC, the embedded Linux A/B update framework.

	  https://github.com/rauc/meta-rauc-community

config KAS_INCLUDE_LAYER_META_RAUC_COMMUNITY
	string
	depends on HAS_LAYER_META_RAUC_COMMUNITY
	default "layers/meta-rauc-community/meta-rauc-community.yaml"

if HAS_LAYER_META_RAUC_COMMUNITY

config HAS_LAYER_META_RAUC_COMMUNITY_META_RAUC_RASPBERRYPI
	bool "meta-rauc-raspberrypi"
	depends on HAS_LAYER_META_RAUC
	depends on HAS_LAYER_POKY_META
	default y if IS_MACHINE_RASPBERRYPI
	help
	  https://github.com/rauc/meta-rauc-community/tree/master/meta-rauc-raspberrypi

config KAS_INCLUDE_LAYER_META_RAUC_COMMUNITY_META_RAUC_RASPBERRYPI
	string
	depends on HAS_LAYER_META_RAUC_COMMUNITY_META_RAUC_RASPBERRYPI
	default "layers/meta-rauc-community/meta-rauc-raspberrypi.yaml"

config HAS_LAYER_META_RAUC_COMMUNITY_META_RAUC_QEMUX86
	bool "meta-rauc-qemux86"
	depends on HAS_LAYER_META_RAUC
	depends on HAS_LAYER_POKY_META
	default y if IS_MACHINE_QEMUX64_64
	help
	  https://github.com/rauc/meta-rauc-community/tree/master/meta-rauc-qemux86

config KAS_INCLUDE_LAYER_META_RAUC_COMMUNITY_META_RAUC_QEMUX86
	string
	depends on HAS_LAYER_META_RAUC_COMMUNITY_META_RAUC_QEMUX86
	default "layers/meta-rauc-community/meta-rauc-qemux86.yaml"

endif # HAS_LAYER_META_RAUC_COMMUNITY
```

## layers/meta-rauc/Kconfig
```kconfig
# SPDX-License-Identifier: LGPL-2.1-only
# SPDX-FileCopyrightText: Copyright 2024-2025 Gaël PORTAY

config HAS_LAYER_META_RAUC
	bool "meta-rauc"
	select HAS_LAYER_META_LTS_MIXINS if IS_BRANCH_SCARTHGAP
	help
	  Yocto/Open Embedded meta layer for RAUC, the embedded Linux
	  update framework.

config KAS_INCLUDE_HAS_LAYER_META_RAUC
	string
	depends on HAS_LAYER_META_RAUC
	default "layers/meta-rauc/meta-rauc.yaml"
```

## layers/meta-riscv/Kconfig
```kconfig
# SPDX-License-Identifier: LGPL-2.1-only
# SPDX-FileCopyrightText: Copyright 2024 Gaël PORTAY

config HAS_LAYER_META_RISCV
	bool "meta-riscv"
	help
	  OpenEmbedded/Yocto layer for RISC-V Architecture.

config KAS_INCLUDE_LAYER_META_RISCV
	string
	depends on HAS_LAYER_META_RISCV
	default "layers/meta-riscv/meta-riscv.yaml"
```

## layers/meta-security/Kconfig
```kconfig
# SPDX-License-Identifier: LGPL-2.1-only
# SPDX-FileCopyrightText: Copyright 2024,2026 Gaël PORTAY

config HAS_LAYER_META_SECURITY
	bool "meta-security"
	select HAS_LAYER_META_OPENEMBEDDED
	select HAS_LAYER_META_OPENEMBEDDED_META_OE
	help
	  Security tools for Internet connected devices

	  https://git.yoctoproject.org/meta-security/

config KAS_INCLUDE_HAS_LAYER_META_SECURITY
	string
	depends on HAS_LAYER_META_SECURITY
	default "layers/meta-security/meta-security.yaml"
```

## layers/meta-yocto/Kconfig
```kconfig
# SPDX-License-Identifier: LGPL-2.1-only
# SPDX-FileCopyrightText: Copyright 2025-2026 Gaël PORTAY

config HAS_LAYER_META_YOCTO
	bool "meta-yocto"
	help
	  Yocto Project integration layers (Poky distro configuration, reference hardware BSPs)

	  https://git.yoctoproject.org/meta-yocto

config KAS_INCLUDE_HAS_LAYER_META_YOCTO
	string
	depends on HAS_LAYER_META_YOCTO
	default "layers/meta-yocto/meta-yocto.yaml"

if HAS_LAYER_META_YOCTO

config HAS_LAYER_META_YOCTO_META_POKY
	bool "meta-poky"
	help
	  https://git.yoctoproject.org/meta-yocto/tree/meta-poky

config KAS_INCLUDE_HAS_LAYER_META_YOCTO_META_POKY
	string
	depends on HAS_LAYER_META_YOCTO_META_POKY
	default "layers/meta-yocto/meta-poky.yaml"

config HAS_LAYER_META_YOCTO_META_YOCTO_BSP
	bool "meta-yocto-bsp"
	help
	  https://git.yoctoproject.org/meta-yocto/tree/meta-yocto-bsp

config KAS_INCLUDE_HAS_LAYER_META_YOCTO_META_YOCTO_BSP
	string
	depends on HAS_LAYER_META_YOCTO_META_YOCTO_BSP
	default "layers/meta-yocto/meta-yocto-bsp.yaml"

endif # HAS_LAYER_META_YOCTO
```

## layers/openembedded-core/Kconfig
```kconfig
# SPDX-License-Identifier: LGPL-2.1-only
# SPDX-FileCopyrightText: Copyright 2025-2026 Gaël PORTAY

config HAS_LAYER_OPENEMBEDDED_CORE
	bool "openembedded-core"
	help
	  OpenEmbedded Core layer.

	  https://git.openembedded.org/openembedded-core/

config KAS_INCLUDE_HAS_LAYER_OPENEMBEDDED_CORE
	string
	depends on HAS_LAYER_OPENEMBEDDED_CORE
	default "layers/openembedded-core/openembedded-core.yaml"

if HAS_LAYER_OPENEMBEDDED_CORE

config HAS_LAYER_OPENEMBEDDED_CORE_META
	bool "meta"
	help
	  https://git.openembedded.org/openembedded-core/tree/meta

config KAS_INCLUDE_HAS_LAYER_OPENEMBEDDED_CORE_META
	string
	depends on HAS_LAYER_OPENEMBEDDED_CORE_META
	default "layers/openembedded-core/meta.yaml"

endif # HAS_LAYER_OPENEMBEDDED_CORE
```

## layers/poky/Kconfig
```kconfig
# SPDX-License-Identifier: LGPL-2.1-only
# SPDX-FileCopyrightText: Copyright 2024 Gaël PORTAY

config HAS_LAYER_POKY
	bool "poky"
	default y
	help
	  Poky Build Tool and Metadata.

	  https://git.yoctoproject.org/poky

config KAS_INCLUDE_HAS_LAYER_POKY
	string
	depends on HAS_LAYER_POKY
	default "layers/poky/poky.yaml"

if HAS_LAYER_POKY

config HAS_LAYER_POKY_META
	bool "meta"
	help
	  https://git.yoctoproject.org/poky/tree/meta

config KAS_INCLUDE_HAS_LAYER_POKY_META
	string
	depends on HAS_LAYER_POKY_META
	default "layers/poky/meta.yaml"

config HAS_LAYER_POKY_META_POKY
	bool "meta-poky"
	select HAS_LAYER_POKY_META
	default y
	help
	  https://git.yoctoproject.org/poky/tree/meta-poky

config KAS_INCLUDE_HAS_LAYER_POKY_META_POKY
	string
	depends on HAS_LAYER_POKY_META_POKY
	default "layers/poky/meta-poky.yaml"

config HAS_LAYER_POKY_META_YOCTO_BSP
	bool "meta-yocto-bsp"
	help
	  https://git.yoctoproject.org/poky/tree/meta-yocto-bsp

config KAS_INCLUDE_HAS_LAYER_POKY_META_YOCTO_BSP
	string
	depends on HAS_LAYER_POKY_META_YOCTO_BSP
	default "layers/poky/meta-yocto-bsp.yaml"

endif # HAS_LAYER_POKY
```

## layers/this/Kconfig
```kconfig
# SPDX-License-Identifier: LGPL-2.1-only
# SPDX-FileCopyrightText: Copyright 2024 Gaël PORTAY

config HAS_LAYER_THIS
	bool "this"
	help
	  OpenEmbedded meta layer with downstream recipes and changes
	  for upstream.

	  https://github.com/gportay/meta-downstream/

config KAS_INCLUDE_LAYER_THIS
	string
	depends on HAS_LAYER_THIS
	default "layers/this/this.yaml"

if HAS_LAYER_THIS

config HAS_LAYER_THIS_META_DOWNSTREAM
	bool "meta-downstream"
	depends on HAS_LAYER_POKY_META
	default y if HAS_DISTRO_FEATURE_SYSTEMD
	help
	  OpenEmbedded meta layer with downstream recipes and changes
	  for upstream.

	  https://github.com/gportay/meta-downstream/tree/master/meta-downstream

config KAS_INCLUDE_LAYER_THIS_META_DOWNSTREAM
	string
	depends on HAS_LAYER_THIS_META_DOWNSTREAM
	default "layers/this/meta-downstream.yaml"

config HAS_LAYER_THIS_META_BLKPG_PART
	bool "meta-blkpg-part"
	depends on HAS_LAYER_POKY_META
	help
	  OpenEmbedded meta layer for partition table and disk geometry
	  handling utility.

	  https://github.com/gportay/meta-downstream/tree/master/meta-downstream

config KAS_INCLUDE_LAYER_THIS_META_BLKPG_PART
	string
	depends on HAS_LAYER_THIS_META_BLKPG_PART
	default "layers/this/meta-blkpg-part.yaml"

config HAS_LAYER_THIS_META_RAUC_RASPBERRYPI_FIRMWARE
	bool "meta-rauc-raspberrypi-firmware"
	depends on HAS_LAYER_META_RAUC
	depends on HAS_LAYER_META_RAUC_COMMUNITY
	depends on HAS_LAYER_META_RAUC_COMMUNITY_META_RAUC_RASPBERRYPI
	help
	  OpenEmbedded meta layer with raspberrypi-firmware integration
	  of RAUC, the embedded Linux A/B update framework.

config KAS_INCLUDE_LAYER_THIS_META_RAUC_RASPBERRYPI_FIRMWARE
	string
	depends on HAS_LAYER_THIS_META_RAUC_RASPBERRYPI_FIRMWARE
	default "layers/this/meta-rauc-raspberrypi-firmware.yaml"

endif # HAS_LAYER_THIS
```

## licenses/Kconfig
```kconfig
# SPDX-License-Identifier: LGPL-2.1-only
# SPDX-FileCopyrightText: Copyright 2025 Gaël PORTAY
# SPDX-FileCopyrightText: The OpenEmbedded Contributors
#
# The help texts are stolen from the Yocto Project Development Tasks Manual.
#
# https://docs.yoctoproject.org/dev-manual/licenses.html#explanation-of-syntax

menu "Licensing"

config HAS_LICENSE_COMMERCIAL
	bool "Enable commercial licenses"
	help
	  Enabling Commercially Licensed Recipes

	  By default, the OpenEmbedded build system disables components
	  that have commercial or other special licensing requirements.

config KAS_INCLUDE_HAS_LICENSE_COMMERCIAL
	string
	default "licenses/commercial.yaml" if HAS_LICENSE_COMMERCIAL

endmenu
```

## machines/Kconfig
```kconfig
# SPDX-License-Identifier: LGPL-2.1-only
# SPDX-FileCopyrightText: Copyright 2024 Gaël PORTAY
#
# The help texts are stolen from the Raspberry Pi Products Website.
#
# https://www.raspberrypi.com/products/

choice
	prompt "Machine"
	default IS_MACHINE_QEMUX86_64

config IS_MACHINE_QEMUARM64
	bool "QEMU ARM (64-bit)"
	select HAS_LAYER_POKY
	select HAS_LAYER_POKY_META
	select HAS_LAYER_POKY_META_POKY
	select HAS_LAYER_POKY_META_YOCTO_BSP
	help
	  https://www.qemu.org/

config IS_MACHINE_QEMUX86_64
	bool "QEMU x86 (64-bit)"
	select HAS_LAYER_POKY
	select HAS_LAYER_POKY_META
	select HAS_LAYER_POKY_META_POKY
	select HAS_LAYER_POKY_META_YOCTO_BSP
	help
	  https://www.qemu.org/

config IS_MACHINE_RASPBERRYPI3_64
	bool "Raspberry Pi 3 (64-bit)"
	select HAS_LAYER_POKY
	select HAS_LAYER_POKY_META
	select HAS_LAYER_POKY_META_POKY
	select HAS_LAYER_META_RASPBERRYPI
	help
	  Raspberry Pi 3 Model B is the earliest model of the
	  third-generation Raspberry Pi. It replaced Raspberry Pi 2
	  Model B in February 2016.

	  https://www.raspberrypi.com/products/raspberry-pi-3-model-b/

config IS_MACHINE_RASPBERRYPI4_64
	bool "Raspberry Pi 4 (64-bit)"
	select HAS_LAYER_POKY
	select HAS_LAYER_POKY_META
	select HAS_LAYER_POKY_META_POKY
	select HAS_LAYER_META_RASPBERRYPI
	help
	  Your tiny, dual-display, desktop computer... and robot brains,
	  smart home hub, media centre, networked AI core, factory
	  controller, and much more.

	  The speed and performance of the new Raspberry Pi 4 is a step
	  up from earlier models. For the first time, we've built a
	  complete desktop experience. Whether you're editing documents,
	  browsing the web with a bunch of tabs open, juggling
	  spreadsheets or drafting a presentation, you'll find the
	  experience smooth and very recognisable — but on a smaller,
	  more energy-efficient and much more cost-effective machine.

	  https://www.raspberrypi.com/products/raspberry-pi-4-model-b/

config IS_MACHINE_RASPBERRYPI5
	bool "Raspberry Pi 5 (64-bit)"
	select HAS_LAYER_POKY
	select HAS_LAYER_POKY_META
	select HAS_LAYER_POKY_META_POKY
	select HAS_LAYER_META_RASPBERRYPI
	help
	  The everything computer. Optimised.

	  With 2–3x the speed of the previous generation, and featuring
	  silicon designed in‑house for the best possible performance,
	  we’ve redefined the Raspberry Pi experience.

	  https://www.raspberrypi.com/products/raspberry-pi-5/

endchoice

config KAS_INCLUDE_MACHINE
	string
	default "machines/qemuarm64.yaml" if IS_MACHINE_QEMUARM64
	default "machines/qemux86-64.yaml" if IS_MACHINE_QEMUX86_64
	default "machines/raspberrypi3-64.yaml" if IS_MACHINE_RASPBERRYPI3_64
	default "machines/raspberrypi4-64.yaml" if IS_MACHINE_RASPBERRYPI4_64
	default "machines/raspberrypi5.yaml" if IS_MACHINE_RASPBERRYPI5
	default ""

source "machines/qemuall/Kconfig"
source "machines/raspberrypi/Kconfig"
```

## machines/aws-ec2/Kconfig
```kconfig
# SPDX-License-Identifier: LGPL-2.1-only AND CC-BY-SA-2.0-UK
# SPDX-FileCopyrightText: Copyright 2024 Gaël PORTAY
# SPDX-FileCopyrightText: The OpenEmbedded Contributors
#
# The help texts are stolen from the Yocto Project Development Tasks Manual.
#
# https://docs.yoctoproject.org/dev/dev-manual/index.html
# https://docs.yoctoproject.org/dev/dev-manual/wic.html
# https://docs.yoctoproject.org/dev/dev-manual/qemu.html

config IS_AWS_EC2
	bool
	default y if IS_MACHINE_AWS_EC2_ARM64 || \
		     IS_MACHINE_AWS_EC2_X86_64

menu "AWS EC2"
	depends on IS_AWS_EC2

config HAS_AWS_EC2_USE_WIC
	bool "Use Wic"
	select HAS_IMAGE_FSTYPES_WIC
	help
	  Generate an Image using an Existing Kickstart File.

	  https://docs.yoctoproject.org/dev/dev-manual/wic.html
	  https://docs.yoctoproject.org/dev/ref-manual/kickstart.html#openembedded-kickstart-wks-reference

config HAS_AWS_EC2_USE_RUNQEMU
	bool "Use runqemu"
	select HAS_IMAGE_CLASSES_QEMUBOOT
	help
	  Within the context of the Yocto Project, QEMU is an emulator
	  and virtualization machine that allows you to run a complete
	  image you have built using the Yocto Project as just another
	  task on your build system. QEMU is useful for running and
	  testing images and applications on supported Yocto Project
	  architectures without having actual hardware.

	  https://docs.yoctoproject.org/dev-manual/qemu.html

	  For official information and documentation on QEMU in general,
	  see the following references:

	  https://wiki.qemu.org/Main_Page
	  https://wiki.qemu.org/Documentation

config KAS_INCLUDE_AWS_EC2_USE_RUNQEMU
	string
	depends on HAS_AWS_EC2_USE_RUNQEMU
	default "machines/aws-ec2/use-runqemu-arm64.yaml" \
		if IS_MACHINE_AWS_EC2_ARM64
	default "machines/aws-ec2/use-runqemu.yaml" \
		if IS_MACHINE_AWS_EC2_X86_64

endmenu
```
