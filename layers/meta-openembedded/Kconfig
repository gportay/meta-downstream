## machines/qemuall/Kconfig
```kconfig
# SPDX-License-Identifier: LGPL-2.1-only AND CC-BY-SA-2.0-UK
# SPDX-FileCopyrightText: Copyright 2024 Gaël PORTAY
# SPDX-FileCopyrightText: The OpenEmbedded Contributors
#
# The help texts are stolen from the Yocto Project Development Tasks Manual.
#
# https://docs.yoctoproject.org/dev/dev-manual/index.html
# https://docs.yoctoproject.org/dev/dev-manual/wic.html

config IS_QEMU
	bool
	default y if IS_MACHINE_QEMUARM64 || \
		     IS_MACHINE_QEMUX86_64

menu "QEMU"
	depends on IS_QEMU

config HAS_QEMUALL_USE_UEFI
	bool "Use UEFI"

config HAS_QEMUALL_USE_UEFI_AND_QEMUARM64
	bool
	default y if IS_MACHINE_QEMUARM64
	depends on HAS_QEMUALL_USE_UEFI
	select HAS_IMAGE_DEPEND_EDK2_FIRMWARE

config KAS_INCLUDE_HAS_QEMUALL_USE_UEFI_AND_QEMUARM64
	string
	depends on HAS_QEMUALL_USE_UEFI_AND_QEMUARM64
	default "machines/qemuall/use-uefi-qemuarm64.yaml"

config HAS_QEMUALL_USE_UEFI_AND_QEMUX86_64
	bool
	default y if IS_MACHINE_QEMUX86_64
	depends on HAS_QEMUALL_USE_UEFI
	select HAS_IMAGE_DEPEND_OVMF

config KAS_INCLUDE_HAS_QEMUALL_USE_UEFI_AND_QEMUX86_64
	string
	depends on HAS_QEMUALL_USE_UEFI_AND_QEMUX86_64
	default "machines/qemuall/use-uefi-qemux86-64.yaml"

config HAS_QEMUALL_USE_WIC
	bool "Use Wic"
	help
	  Generate an Image using an Existing Kickstart File.

	  https://docs.yoctoproject.org/dev/dev-manual/wic.html
	  https://docs.yoctoproject.org/dev/ref-manual/kickstart.html#openembedded-kickstart-wks-reference

config KAS_INCLUDE_HAS_QEMUALL_USE_WIC
	string
	depends on HAS_QEMUALL_USE_WIC
	default "machines/qemuall/use-wic-qemuarm64.yaml" \
		if IS_MACHINE_QEMUARM64
	default "machines/qemuall/use-wic-qemux86-64.yaml" \
		if IS_MACHINE_QEMUX86_64
	default ""

config HAS_QEMUALL_USE_UEFI_AND_WIC
	bool
	default y if HAS_QEMUALL_USE_UEFI && \
		     HAS_QEMUALL_USE_WIC
	select HAS_IMAGE_INSTALL_GRUB_EFI

config HAS_QEMUALL_USE_WIC_AND_QEMUARM64
	bool
	default y if HAS_QEMUALL_USE_WIC && \
		     IS_MACHINE_QEMUARM64
	select HAS_QEMUALL_USE_UEFI

endmenu
```

## machines/raspberrypi/Kconfig
```kconfig
# SPDX-License-Identifier: LGPL-2.1-only AND CC-BY-SA-4.0
# SPDX-FileCopyrightText: Copyright 2024-2025 Gaël PORTAY
# SPDX-FileCopyrightText: Copyright 2012-2025 Raspberry Pi Ltd
#
# The help texts are stolen from the Raspberry Pi documentation.
#
# https://www.raspberrypi.com/documentation/computers/config_txt.html
# https://www.raspberrypi.com/documentation/computers/raspberry-pi.html

config IS_RASPBERRYPI
	bool
	default y if IS_MACHINE_RASPBERRYPI2_64 || \
	             IS_MACHINE_RASPBERRYPI3_64 || \
		     IS_MACHINE_RASPBERRYPI4_64 || \
		     IS_MACHINE_RASPBERRYPI5

menu "Raspberry Pi"
	depends on IS_RASPBERRYPI

choice
	prompt "Bootloader"
	default IS_RASPBERRYPI_BOOTLOADER_RASPBERRYPI_FIRMWARE

config IS_RASPBERRYPI_BOOTLOADER_RASPBERRYPI_FIRMWARE
	bool "Raspberry Pi Firmware"
	help
	  https://www.raspberrypi.com/documentation/computers/config_txt.html

config IS_RASPBERRYPI_BOOTLOADER_U_BOOT
	bool "U-Boot"
	depends on !IS_MACHINE_RASPBERRYPI5
	help
	  https://docs.u-boot.org/en/latest/

endchoice

config KAS_INCLUDE_IS_RASPBERRYPI_BOOTLOADER_U_BOOT
	string
	depends on IS_RASPBERRYPI_BOOTLOADER_U_BOOT
	default "machines/raspberrypi/use-u-boot.yaml"

config HAS_RASPBERRYPI_FIRMWARE_ENABLE_UART
	bool "Enable UART"
	depends on IS_RASPBERRYPI_BOOTLOADER_RASPBERRYPI_FIRMWARE
	help
	  Requests that the kernel creates a serial console, accessible
	  using GPIOs 14 and 15 (pins 8 and 10 on the 40-pin header).

	  https://www.raspberrypi.com/documentation/computers/config_txt.html#enable_uart

config KAS_INCLUDE_HAS_RASPBERRYPI_FIRMWARE_ENABLE_UART
	string
	depends on HAS_RASPBERRYPI_FIRMWARE_ENABLE_UART
	default "machines/raspberrypi/enable-uart.yaml"

config HAS_RASPBERRYPI_FIRMWARE_USE_AUTOBOOT_TXT
	bool "Use autoboot.txt"
	depends on IS_RASPBERRYPI_BOOTLOADER_RASPBERRYPI_FIRMWARE
	select HAS_LAYER_META_RAUC
	select HAS_LAYER_META_RAUC_COMMUNITY
	select HAS_LAYER_THIS
	select HAS_LAYER_THIS_META_RAUC_RASPBERRYPI_FIRMWARE
	help
	  Generated autoboot.txt file for the Raspberry Pi. The
	  Raspberry Pi autoboot.txt file is read by the GPU before the
	  ARM core is initialised. It can be used to specify the
	  boot_partition number. It can also be used in conjuncion with
	  the tryboot feature to implement A/B booting for OS upgrades.

	  https://www.raspberrypi.com/documentation/computers/config_txt.html#autoboot-txt

	  autoboot.txt is an optional configuration file that can be
	  used to specify the boot_partition number.

	  This can also be used in conjunction with the tryboot feature
	  to implement A/B booting for OS upgrades.

	  autoboot.txt is limited to 512 bytes and supports the [all],
	  [none] and [tryboot] conditional filters.

	  https://www.raspberrypi.com/documentation/computers/raspberry-pi.html#fail-safe-os-updates-tryboot

	  The bootloader/firmware provide a one-shot flag which, if set,
	  is cleared but causes tryboot.txt to be loaded instead of
	  config.txt. This alternate config would specify the pending OS
	  update firmware, cmdline, kernel and os_prefix parameters.
	  Since the flag is cleared before starting the firmware, a
	  crash or reset will cause the original config.txt file to be
	  loaded on the next reboot.

	  https://www.raspberrypi.com/documentation/computers/raspberry-pi.html#fail-safe-os-updates-tryboot

config KAS_INCLUDE_HAS_RASPBERRYPI_FIRMWARE_USE_AUTOBOOT_TXT
	string
	depends on HAS_RASPBERRYPI_FIRMWARE_USE_AUTOBOOT_TXT
	default "machines/raspberrypi/use-autoboot-txt.yaml"

config HAS_RASPBERRYPI_USE_INITRAMFS_IMAGE
	bool
	depends on !IS_RASPBERRYPI_BOOTLOADER_U_BOOT
	depends on HAS_INITRAMFS_IMAGE
	depends on !HAS_INITRAMFS_IMAGE_BUNDLE
	select HAS_LAYER_THIS
	select HAS_LAYER_THIS_META_DOWNSTREAM
	default y

config KAS_INCLUDE_HAS_RASPBERRYPI_USE_INITRAMFS_IMAGE
	string
	depends on HAS_RASPBERRYPI_USE_INITRAMFS_IMAGE
	default "machines/raspberrypi/use-initramfs-image.yaml"

config HAS_RASPBERRYPI_USE_INITRAMFS_IMAGE_BUNDLE
	bool
	depends on !IS_RASPBERRYPI_BOOTLOADER_U_BOOT
	depends on HAS_INITRAMFS_IMAGE
	depends on HAS_INITRAMFS_IMAGE_BUNDLE
	default y

config KAS_INCLUDE_HAS_RASPBERRYPI_USE_INITRAMFS_IMAGE_BUNDLE
	string
	depends on HAS_RASPBERRYPI_USE_INITRAMFS_IMAGE_BUNDLE
	default "machines/raspberrypi/use-initramfs-image-bundle.yaml"

config HAS_RASPBERRYPI_USE_DM_VERITY_IMG
	bool
	depends on HAS_IMAGE_CLASSES_DM_VERITY_IMG
	default y

config KAS_INCLUDE_HAS_RASPBERRYPI_USE_DM_VERITY_IMG
	string
	depends on HAS_RASPBERRYPI_USE_DM_VERITY_IMG
	default "machines/raspberrypi/use-dm-verity-img.yaml"

endmenu
```

## meta-backport-kirkstone/conf/layer.conf
```bitbake
# We have a conf and classes directory, add to BBPATH
BBPATH .= ":${LAYERDIR}"

# We have recipes-* directories, add to BBFILES
BBFILES += "${LAYERDIR}/recipes-*/*/*.bb \
            ${LAYERDIR}/recipes-*/*/*.bbappend"

BBFILE_COLLECTIONS += "meta-backport-kirkstone"
BBFILE_PATTERN_meta-backport-kirkstone = "^${LAYERDIR}/"
BBFILE_PRIORITY_meta-backport-kirkstone = "20"

LAYERDEPENDS_meta-backport-kirkstone = "core rauc"
LAYERSERIES_COMPAT_meta-backport-kirkstone = "kirkstone"
```

## meta-backport-scarthgap/conf/layer.conf
```bitbake
# We have a conf and classes directory, add to BBPATH
BBPATH .= ":${LAYERDIR}"

# We have recipes-* directories, add to BBFILES
BBFILES += "${LAYERDIR}/recipes-*/*/*.bb \
            ${LAYERDIR}/recipes-*/*/*.bbappend"

BBFILE_COLLECTIONS += "meta-backport-scarthgap"
BBFILE_PATTERN_meta-backport-scarthgap = "^${LAYERDIR}/"
BBFILE_PRIORITY_meta-backport-scarthgap = "10"

LAYERDEPENDS_meta-backport-scarthgap = "core rauc"
LAYERSERIES_COMPAT_meta-backport-scarthgap = "scarthgap"
```

## meta-downstream/conf/layer.conf
```bitbake
# We have a conf and classes directory, add to BBPATH
BBPATH .= ":${LAYERDIR}"

# We have recipes-* directories, add to BBFILES
BBFILES += "${LAYERDIR}/recipes-*/*/*.bb \
            ${LAYERDIR}/recipes-*/*/*.bbappend"

BBFILE_COLLECTIONS += "meta-downstream"
BBFILE_PATTERN_meta-downstream = "^${LAYERDIR}/"
BBFILE_PRIORITY_meta-downstream = "10"

LAYERDEPENDS_meta-downstream = "core"
LAYERSERIES_COMPAT_meta-downstream = "kirkstone scarthgap styhead walnascar whinlatter wrynose"

BBFILES_DYNAMIC += " \
  raspberrypi:${LAYERDIR}/dynamic-layers/meta-raspberrypi/recipes-*/*/*.bb \
  raspberrypi:${LAYERDIR}/dynamic-layers/meta-raspberrypi/recipes-*/*/*.bbappend \
  meta-rauc-qemux86:${LAYERDIR}/dynamic-layers/meta-rauc-qemux86/recipes-*/*/*.bb \
  meta-rauc-qemux86:${LAYERDIR}/dynamic-layers/meta-rauc-qemux86/recipes-*/*/*.bbappend \
"
```

## meta-rauc-raspberrypi-firmware/conf/layer.conf
```bitbake
# We have a conf and classes directory, add to BBPATH
BBPATH .= ":${LAYERDIR}"

# We have recipes-* directories, add to BBFILES
BBFILES += "${LAYERDIR}/recipes-*/*/*.bb \
            ${LAYERDIR}/recipes-*/*/*.bbappend"

BBFILE_COLLECTIONS += "meta-rauc-raspberrypi-firmware"
BBFILE_PATTERN_meta-rauc-raspberrypi-firmware = "^${LAYERDIR}/"
BBFILE_PRIORITY_meta-rauc-raspberrypi-firmware = "10"

LAYERDEPENDS_meta-rauc-raspberrypi-firmware = "meta-rauc-raspberrypi"
LAYERSERIES_COMPAT_meta-rauc-raspberrypi-firmware = "kirkstone scarthgap styhead walnascar"
```

## quirks/Kconfig
```kconfig
# SPDX-License-Identifier: LGPL-2.1-only AND CC-BY-SA-2.0-UK
# SPDX-FileCopyrightText: Copyright 2024-2025 Gaël PORTAY
# SPDX-FileCopyrightText: The OpenEmbedded Contributors
#
# The help texts are stolen from the Yocto Project Release Information.
#
# https://docs.yoctoproject.org/dev/migration-guides/index.html
# https://docs.yoctoproject.org/dev/migration-guides/migration-5.1.html#workdir-references-in-recipes

config HAS_QUIRK_UNPACKDIR
	bool "Set UNPACKDIR to ${WORKDIR}"
	depends on IS_BRANCH_SCARTHGAP
	help
	  Since Skyhead (5.1), WORKDIR references in other recipes need
	  auditing. If they reference files from SRC_URI, they likely
	  need changing to UNPACKDIR. These are commonly in do_compile
	  and do_install for things like service or configuration files.
	  One unusual case is ${WORKDIR}/${BP} which should probably be
	  set to ${S}.

	  References to ../ in LIC_FILES_CHKSUM or elsewhere may need
	  changing to UNPACKDIR. References to WORKDIR in sed commands
	  are usually left as they are.

	  https://docs.yoctoproject.org/dev/ref-manual/variables.html#term-UNPACKDIR
	  https://docs.yoctoproject.org/dev/migration-guides/migration-5.1.html#workdir-references-in-recipes
	  https://git.yoctoproject.org/poky/commit/?id=812dafbec1918fbbf89e8466988da602bf5edee0
	  https://git.yoctoproject.org/poky/commit/?id=d24a7d0fb16457e10e7a216d4c9ae3fb265113d1

config KAS_INCLUDE_HAS_QUIRK_UNPACKDIR
	string
	depends on HAS_QUIRK_UNPACKDIR
	default "quirks/unpackdir.yaml"

config HAS_QUIRK_S_WORKDIR_SOMETHING
	bool "Set S to ${WORKING}/something"
	depends on IS_BRANCH_SCARTHGAP
	help
	  S = ${WORKDIR}/something no longer supported

	  Since Whinlatter (5.3), if a recipe has S set to be
	  ${WORKDIR}/something, this is no longer supported, and an
	  error will be issued. The recipe should be changed to:
	  S = "${UNPACKDIR}/something"

	  https://docs.yoctoproject.org/dev/migration-guides/migration-5.3.html#s-workdir-something-no-longer-supported
	  https://docs.yoctoproject.org/dev/ref-manual/variables.html#term-WORKDIR

config KAS_INCLUDE_HAS_QUIRK_S_WORKDIR_SOMETHING
	string
	depends on HAS_QUIRK_S_WORKDIR_SOMETHING
	default "quirks/s-workdir-something.yaml"

config HAS_QUIRK_S_UNPACKDIR_GIT
	bool "Set S to ${UNPACKDIR}/git"
	depends on IS_BRANCH_SCARTHGAP
	select HAS_QUIRK_UNPACKDIR
	help
	  S = ${WORKDIR}/something no longer supported

	  Since Whinlatter (5.3), if a recipe has S set to be
	  ${WORKDIR}/something, this is no longer supported, and an
	  error will be issued. The recipe should be changed to:
	  S = "${UNPACKDIR}/something"

	  S = ${WORKDIR}/git and S = ${UNPACKDIR}/git should be removed

	  Since Whinlatter (5.3), the Git fetcher now unpacks into the
	  BB_GIT_DEFAULT_DESTSUFFIX directory rather than the git/
	  directory under UNPACKDIR. BB_GIT_DEFAULT_DESTSUFFIX is set
	  in OpenEmbedded-Core (OE-Core)’s bitbake.conf to BP.

	  This location matches the default value of S set by
	  bitbake.conf, so S setting in recipes can and should be
	  removed.

	  Note that when S is set to a subdirectory of the git checkout
	  then it should be instead adjusted according to the previous
	  point:

	    S = "${UNPACKDIR}/${BP}/something"

	  Note that “git” as the source checkout location can be
	  hardcoded in other places in recipes; when it’s in SRC_URI,
	  replace with BB_GIT_DEFAULT_DESTSUFFIX, otherwise replace
	  with BP.

	  https://docs.yoctoproject.org/dev/migration-guides/migration-5.3.html#s-workdir-git-and-s-unpackdir-git-should-be-removed
	  https://docs.yoctoproject.org/dev/ref-manual/variables.html#term-BB_GIT_DEFAULT_DESTSUFFIX
	  https://docs.yoctoproject.org/dev/ref-manual/variables.html#term-UNPACKDIR
	  https://docs.yoctoproject.org/dev/ref-manual/variables.html#term-BP
	  https://git.openembedded.org/openembedded-core/tree/meta/conf/bitbake.conf#n411

config KAS_INCLUDE_HAS_QUIRK_S_UNPACKDIR_GIT
	string
	depends on HAS_QUIRK_S_UNPACKDIR_GIT
	default "quirks/s-unpackdir-git.yaml"

config HAS_QUIRK_REMOVE_LINUX_CORAL_QA_ERRORS
	bool "Remove linux-coral QA Errors"
	depends on IS_BRANCH_MASTER
	default y if HAS_LAYER_META_CORAL
	help
	  The Upstream-Status value is missing in the specified patch
	  file’s header. This value is intended to track whether or not
	  the patch has been sent upstream, whether or not it has been
	  merged, etc.

	  There are two options for this same check - patch-status-core
	  (for recipes in OE-Core) and patch-status-noncore (for recipes
	  in any other layer).

	  For more information, see the “Patch Upstream Status” section
	  in the Yocto Project and OpenEmbedded Contributor Guide.

	  https://docs.yoctoproject.org/dev/ref-manual/qa-checks.html
	  https://docs.yoctoproject.org/dev/contributor-guide/recipe-style-guide.html#patch-upstream-status

config KAS_INCLUDE_HAS_QUIRK_REMOVE_LINUX_CORAL_QA_ERRORS
	string
	depends on HAS_QUIRK_REMOVE_LINUX_CORAL_QA_ERRORS
	default "quirks/remove-linux-coral-qa-errors.yaml"
```
