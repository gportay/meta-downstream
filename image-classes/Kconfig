## image-classes/Kconfig
```kconfig
# SPDX-License-Identifier: LGPL-2.1-only AND CC-BY-SA-2.0-UK
# SPDX-FileCopyrightText: Copyright 2024,2026 Gaël PORTAY
# SPDX-FileCopyrightText: The OpenEmbedded Contributors
#
# The help texts are stolen from meta-security and openembedded-core layers.
#
# https://git.yoctoproject.org/meta-security/tree/classes/dm-verity-img.bbclass
# https://github.com/openembedded/openembedded-core/tree/master/meta/classes-recipe/grub-efi-cfg.bbclass
# https://github.com/openembedded/openembedded-core/tree/master/meta/classes-recipe/qemuboot.bbclass
# https://github.com/openembedded/openembedded-core/tree/master/meta/classes-recipe/syslinux.bbclass
# https://github.com/openembedded/openembedded-core/tree/master/meta/classes-recipe/systemd-boot-cfg.bbclass

menu "Image Classes"

config HAS_IMAGE_CLASSES_GRUB_EFI_CFG
	bool "Class grub-efi-cfg"
	depends on HAS_MACHINE_FEATURES_EFI
	help
	  Provide grub-efi specific functions for building bootable
	  images.

	  https://github.com/openembedded/openembedded-core/tree/master/meta/classes-recipe/grub-efi-cfg.bbclass

config KAS_INCLUDE_HAS_IMAGE_CLASSES_GRUB_EFI_CFG
	string
	depends on HAS_IMAGE_CLASSES_GRUB_EFI_CFG
	default "image-classes/grub-efi-cfg.yaml"

config HAS_IMAGE_CLASSES_QEMUBOOT
	bool "Class qemuboot"
	help
	  Help runqemu boot target board.

	  https://github.com/openembedded/openembedded-core/tree/master/meta/classes-recipe/qemuboot.bbclass

config KAS_INCLUDE_HAS_IMAGE_CLASSES_QEMUBOOT
	string
	depends on HAS_IMAGE_CLASSES_QEMUBOOT
	default "image-classes/qemuboot.yaml"

config HAS_IMAGE_CLASSES_SYSLINUX
	bool "Class syslinux"
	depends on IS_MACHINE_QEMUX86_64
	help
	  Provide syslinux specific functions for building bootable
	  images.

	  https://github.com/openembedded/openembedded-core/tree/master/meta/classes-recipe/syslinux.bbclass

config KAS_INCLUDE_HAS_IMAGE_CLASSES_SYSLINUX
	string
	depends on HAS_IMAGE_CLASSES_SYSLINUX
	default "image-classes/syslinux.yaml"

config HAS_IMAGE_CLASSES_SYSTEMD_BOOT_CFG
	bool "Class systemd-boot-cfg"
	depends on HAS_MACHINE_FEATURES_EFI
	help
	  Provide systemd-boot specific functions for building bootable
	  images.

	  https://github.com/openembedded/openembedded-core/tree/master/meta/classes-recipe/systemd-boot-cfg.bbclass

config KAS_INCLUDE_HAS_IMAGE_CLASSES_SYSTEMD_BOOT_CFG
	string
	depends on HAS_IMAGE_CLASSES_SYSTEMD_BOOT_CFG
	default "image-classes/systemd-boot-cfg.yaml"

config HAS_IMAGE_CLASSES_DM_VERITY_IMG
	bool "Class dm-verity-img"
	select HAS_LAYER_META_SECURITY
	select HAS_LAYER_THIS
	select HAS_LAYER_THIS_META_DOWNSTREAM
	select HAS_DISTRO_FEATURE_SECURITY
	select HAS_IMAGE_FEATURE_READ_ONLY_ROOTFS
	select HAS_INITRAMFS_IMAGE
	help
	  This bbclass allows creating of dm-verity protected partition
	  images. It generates a device image file with dm-verity hash
	  data appended at the end plus the corresponding .env file
	  containing additional information needed to mount the image
	  such as the root hash in the form of ell variables. To assure
	  data integrity, the root hash must be stored in a trusted
	  location or cryptographically signed and verified.

	  https://git.yoctoproject.org/meta-security/tree/classes/dm-verity-img.bbclass

config KAS_INCLUDE_HAS_IMAGE_CLASSES_DM_VERITY_IMG
	string
	depends on HAS_IMAGE_CLASSES_DM_VERITY_IMG
	default "image-classes/dm-verity-img.yaml"

if HAS_IMAGE_CLASSES_DM_VERITY_IMG

config HAS_IMAGE_CLASSES_DM_VERITY_IMG_SEPARATE_HASH
	bool "Store hash on separate device"
	help
	  Optionally, we can store the hash data on a separate device
	  or partition for improved compartmentalization and ease of
	  use/deployment.

config KAS_INCLUDE_HAS_IMAGE_CLASSES_DM_VERITY_IMG_SEPARATE_HASH
	string
	depends on HAS_IMAGE_CLASSES_DM_VERITY_IMG_SEPARATE_HASH
	default "image-classes/dm-verity-img-separate-hash.yaml"
endif

source "image-classes/qemuboot/Kconfig"

endmenu
```

## image-fstypes/Kconfig
```kconfig
# SPDX-License-Identifier: LGPL-2.1-only AND MIT AND CC-BY-SA-2.0-UK
# SPDX-FileCopyrightText: Copyright 2024,2026 Gaël PORTAY
# SPDX-FileCopyrightText: The OpenEmbedded Contributors
#
# The help texts are stolen from the Yocto Project Reference Manual, the Yocto
# Project Development Tasks Manual and from meta-raspberrypi and meta-security
# layers.
#
# https://docs.yoctoproject.org/dev/dev-manual/index.html
# https://docs.yoctoproject.org/dev/dev-manual/wic.html
# https://docs.yoctoproject.org/ref-manual/variables.html#term-WKS_FILE

menu "Image FileSystem Types"

config HAS_IMAGE_FSTYPES_EXT4
	bool "ext4"
	help
	  Ext4 is an advanced level of the ext3 filesystem which
	  incorporates scalability and reliability enhancements for
	  supporting large filesystems (64 bit) in keeping with
	  increasing disk capacities and state-of-the-art feature
	  requirements.

	  https://docs.kernel.org/admin-guide/ext4.html
	  https://www.kernel.org/doc/html/latest/filesystems/ext4/index.html
	  https://www.nongnu.org/ext2-doc/ext2.html

config KAS_INCLUDE_HAS_IMAGE_FSTYPES_EXT4
	string
	depends on HAS_IMAGE_FSTYPES_EXT4
	default "image-fstypes/ext4.yaml"

config HAS_IMAGE_FSTYPES_WIC
	bool "Wic"
	help
	  Generate an Image using an Existing Kickstart File.

	  https://docs.yoctoproject.org/dev/dev-manual/wic.html
	  https://docs.yoctoproject.org/dev/ref-manual/kickstart.html#openembedded-kickstart-wks-reference

config KAS_INCLUDE_HAS_IMAGE_FSTYPES_WIC
	string
	depends on HAS_IMAGE_FSTYPES_WIC
	default "image-fstypes/wic.yaml"

config HAS_IMAGE_FSTYPES_USE_WKS_FILE
	bool "Use WKS file"
	depends on HAS_IMAGE_FSTYPES_WIC
	help
	  Specifies the location of the Wic kickstart file that is used
	  by the OpenEmbedded build system to create a partitioned
	  image (image.wic).

if HAS_IMAGE_FSTYPES_USE_WKS_FILE

choice
	prompt "Wic Kickstart file"
	default IS_WKS_FILE_EFI_BOOTDISK_DMVERITY_BOOTLOADER_CONFIG if HAS_IMAGE_CLASSES_DM_VERITY_IMG && \
	                                                               (HAS_IMAGE_CLASSES_GRUB_EFI_CFG || \
	                                                                HAS_IMAGE_CLASSES_SYSTEMD_BOOT_CFG)
	default IS_WKS_FILE_SDIMAGE_AUTOBOOT_TRYBOOT_RASPBERRYPI if HAS_RASPBERRYPI_FIRMWARE_USE_AUTOBOOT_TXT
	default IS_WKS_FILE_SDIMAGE_RASPBERRYPI_DMVERITY if HAS_IMAGE_CLASSES_DM_VERITY_IMG && IS_RASPBERRYPI
	default IS_WKS_FILE_SYSTEMD_BOOTDISK_DMVERITY if HAS_IMAGE_CLASSES_DM_VERITY_IMG && IS_MACHINE_QEMUX86_64

config IS_WKS_FILE_EFI_BOOTDISK_DMVERITY_BOOTLOADER_CONFIG
	bool "efi-disk-dmverity-bootloader-config.wks.in"
	help
	  Create an EFI disk image with custom bootloader config and
	  dm-verity

	  Creates a partitioned EFI disk image that the user can
	  directly dd to boot media. The bootloader configuration
	  source is a generated user file. We need to fetch the
	  partition images from the IMGDEPLOYDIR as the rootfs source
	  plugin will not recreate the exact block device corresponding
	  with the hash tree. We must not alter the label or any other
	  setting on the image.

	  Based on meta-security's systemd-bootdisk-dmverity.wks.in file

	  This .wks only works with the dm-verity-img class.

config IS_WKS_FILE_SDIMAGE_AUTOBOOT_TRYBOOT_RASPBERRYPI
	bool "sdimage-autoboot+tryboot-raspberrypi.wks"

config IS_WKS_FILE_SDIMAGE_RASPBERRYPI_DMVERITY
	bool "sdimage-raspberrypi-dmverity.wks.in"
	help
	  Create Raspberry Pi SD card image with dm-verity

	  Creates a partitioned SD card image for use with Raspberry
	  Pi. Boot files are located in the first vfat partition. A
	  dm-verity variant of the regular wks for Raspberry Pi
	  machines. We need to fetch the partition images from the
	  IMGDEPLOYDIR as the rootfs source plugin will not recreate
	  the exact block device corresponding with the hash tree. We
	  must not alter the label or any other setting on the image.

	  Based on meta-raspberrypi's sdimage-raspberrypi and
	  meta-security's systemd-bootdisk-dmverity.wks.in files

	  This .wks only works with the dm-verity-img class.

config IS_WKS_FILE_SYSTEMD_BOOTDISK_DMVERITY
	bool "systemd-bootdisk-dmverity.wks.in"
	help
	  Create an EFI disk image with systemd-boot and dm-verity

	  A dm-verity variant of the regular wks for IA machines. We
	  need to fetch the partition images from the IMGDEPLOYDIR as
	  the rootfs source plugin will not recreate the exact block
	  device corresponding with the hash tree. We must not alter
	  the label or any other setting on the image.

	  Based on OE-core's systemd-bootdisk.wks and meta-security's
	  beaglebone-yocto-verity.wks.in file

	  This .wks only works with the dm-verity-img class.

endchoice

config KAS_INCLUDE_HAS_IMAGE_FSTYPES_USE_WKS_FILE
	string
	default "image-fstypes/efi-disk-dmverity-bootloader-config.yaml" if IS_WKS_FILE_EFI_BOOTDISK_DMVERITY_BOOTLOADER_CONFIG
	default "image-fstypes/sdimage-autoboot+tryboot-raspberrypi.yaml" if IS_WKS_FILE_SDIMAGE_AUTOBOOT_TRYBOOT_RASPBERRYPI
	default "image-fstypes/sdimage-raspberrypi-dmverity.yaml" if IS_WKS_FILE_SDIMAGE_RASPBERRYPI_DMVERITY
	default "image-fstypes/systemd-bootdisk-dmverity.yaml" if IS_WKS_FILE_SYSTEMD_BOOTDISK_DMVERITY
	default ""

endif

endmenu
```

## inherits/Kconfig
```kconfig
# SPDX-License-Identifier: (MIT OR LGPL-2.1-only) AND CC-BY-SA-2.0-UK
# SPDX-FileCopyrightText: Copyright 2024,2026 Gaël PORTAY
# SPDX-FileCopyrightText: Copyright 2026 Rtone
# SPDX-FileCopyrightText: Copyright 2024 iris-GmbH infrared & intelligent sensors
# SPDX-FileCopyrightText: Copyright 2024 Savoir-faire Linux Inc.
# SPDX-FileCopyrightText: Copyright 2022 BG Networks, Inc.
# SPDX-FileCopyrightText: The OpenEmbedded Contributors
#
# The help texts are stolen from the Yocto Project Reference Manual.
#
# https://docs.yoctoproject.org/dev/ref-manual/classes.html#create-spdx
# https://docs.yoctoproject.org/dev/ref-manual/classes.html#rm-work
# https://docs.yoctoproject.org/dev/ref-manual/classes.html#vex
# https://docs.yoctoproject.org/dev/ref-manual/index.html
# https://github.com/iris-GmbH/meta-cyclonedx/blob/main/README.md

menu "Global Classes"

config HAS_INHERIT_CREATE_SPDX_3_0
	bool "Inherit create-spdx-3.0"
	depends on IS_BRANCH_SCARTHGAP
	default y
	help
	  The create-spdx class provides support for automatically
	  creating SPDX SBOM documents based upon image and SDK
	  contents.

	  https://docs.yoctoproject.org/ref-manual/classes.html#create-spdx

config KAS_INCLUDE_HAS_INHERIT_CREATE_SPDX_3_0
	string
	depends on HAS_INHERIT_CREATE_SPDX_3_0
	default "inherits/create-spdx-3.0.yaml"

config HAS_INHERIT_CYCLONEDX_EXPORT
	bool "Inherit cyclonedx-export"
	select HAS_LAYER_META_CYCLONEDX
	help
	  Produces CycloneDX Software Bill of Materials (aka SBOMs)
	  from your target root filesystem.

	  https://github.com/iris-GmbH/meta-cyclonedx/blob/main/README.md

config KAS_INCLUDE_HAS_INHERIT_CYCLONEDX_EXPORT
	string
	depends on HAS_INHERIT_CYCLONEDX_EXPORT
	default "inherits/cyclonedx-export.yaml"

choice
	prompt "CycloneDX Specification Version selection"
	depends on HAS_INHERIT_CYCLONEDX_EXPORT
	default IS_INHERIT_CYCLONEDX_EXPORT_CYCLONEDX_IMAGE_VERSION_1_4 if IS_BRANCH_SCARTHGAP
	default IS_INHERIT_CYCLONEDX_EXPORT_CYCLONEDX_IMAGE_VERSION_1_6
	help
	  By default, meta-cyclonedx generates CycloneDX 1.4 format
	  SBOMs.

	  https://github.com/iris-GmbH/meta-cyclonedx/blob/main/README.md#cyclonedx-specification-version

config IS_INHERIT_CYCLONEDX_EXPORT_CYCLONEDX_IMAGE_VERSION_1_4
	bool "1.4"
	help
	  Legacy format for compatibility with older tools.

config IS_INHERIT_CYCLONEDX_EXPORT_CYCLONEDX_IMAGE_VERSION_1_6
	bool "1.6"
	help
	  Modern format with enhanced metadata and timestamps.

config IS_INHERIT_CYCLONEDX_EXPORT_CYCLONEDX_IMAGE_VERSION_1_7
	bool "1.7"
	help
	  Latest version with advanced cryptography transparency
	  (CBOM), intellectual property visibility, citations, and
	  improved custom license handling

endchoice

if HAS_INHERIT_CYCLONEDX_EXPORT

config KAS_INCLUDE_IS_INHERIT_CYCLONEDX_EXPORT_CYCLONEDX_IMAGE_VERSION_1_4
	string
	depends on IS_INHERIT_CYCLONEDX_EXPORT_CYCLONEDX_IMAGE_VERSION_1_4
	default "inherits/cyclonedx-export-cyclonedx-image-version-1.4.yaml"

config KAS_INCLUDE_IS_INHERIT_CYCLONEDX_EXPORT_HAS_CYCLONEDX_IMAGE_VERSION_1_6
	string
	depends on IS_INHERIT_CYCLONEDX_EXPORT_CYCLONEDX_IMAGE_VERSION_1_6
	default "inherits/cyclonedx-export-cyclonedx-image-version-1.6.yaml"

config KAS_INCLUDE_IS_INHERIT_CYCLONEDX_EXPORT_HAS_CYCLONEDX_IMAGE_VERSION_1_7
	string
	depends on IS_INHERIT_CYCLONEDX_EXPORT_CYCLONEDX_IMAGE_VERSION_1_7
	default "inherits/cyclonedx-export-cyclonedx-image-version-1.7.yaml"

config HAS_INHERIT_CYCLONEDX_EXPORT_NO_CYCLONEDX_RUNTIME_PACKAGES_ONLY
	bool "Disable runtime packages only"
	help
	  Runtime vs Build-time Packages

	  By default, meta-cyclonedx will only include run-time
	  packages in the SBOM, which drastically reduces the number of
	  potentially irrelevant packages. However, this can lead to
	  valid packages being omitted from the SBOM, see
	  https://github.com/iris-GmbH/meta-cyclonedx/blob/scarthgap/README.md#potentially-missing-packages-after-run-time-filtering

	  https://github.com/iris-GmbH/meta-cyclonedx/blob/scarthgap/README.md#runtime-vs-build-time-packages

config KAS_INCLUDE_HAS_INHERIT_CYCLONEDX_EXPORT_DISABLE_CYCLONEDX_RUNTIME_PACKAGES_ONLY
	string
	depends on HAS_INHERIT_CYCLONEDX_EXPORT_DISABLE_CYCLONEDX_RUNTIME_PACKAGES_ONLY
	default "inherits/cyclonedx-export-no-cyclonedx-runtime-package-only.yaml"

endif

config HAS_INHERIT_CVE_CHECK
	bool "Inherit cve-check"
	depends on IS_BRANCH_SCARTHGAP
	help
	  The cve-check class looks for known CVEs (Common
	  Vulnerabilities and Exposures) while building with BitBake.

	  https://docs.yoctoproject.org/ref-manual/classes.html#cve-check

config KAS_INCLUDE_HAS_INHERIT_CVE_CHECK
	string
	depends on HAS_INHERIT_CVE_CHECK
	default "inherits/cve-check.yaml"

config HAS_INHERIT_RM_WORK
	bool "Inherit rm_work"
	help
	  The rm_work class supports deletion of temporary workspace,
	  which can ease your hard drive demands during builds.

	  The OpenEmbedded build system can use a substantial amount of
	  disk space during the build process. A portion of this space
	  is the work files under the ${TMPDIR}/work directory for each
	  recipe. Once the build system generates the packages for a
	  recipe, the work files for that recipe are no longer needed.
	  However, by default, the build system preserves these files
	  for inspection and possible debugging purposes. If you would
	  rather have these files deleted to save disk space as the
	  build progresses, you can enable rm_work.

	  https://docs.yoctoproject.org/ref-manual/classes.html#rm-work

config KAS_INCLUDE_HAS_INHERIT_RM_WORK
	string
	depends on HAS_INHERIT_RM_WORK
	default "inherits/rm_work.yaml"

config HAS_INHERIT_VEX
	bool "Inherit vex"
	help
	  The vex class is used to generate metadata needed by external
	  tools to check for vulnerabilities, for example CVEs. It can
	  be used as a replacement for cve-check.

	  https://docs.yoctoproject.org/ref-manual/classes.html#vex

config KAS_INCLUDE_HAS_INHERIT_VEX
	string
	depends on HAS_INHERIT_VEX
	default "inherits/vex.yaml"

endmenu
```
