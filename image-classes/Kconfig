## kernel-features/Kconfig
```kconfig
# SPDX-License-Identifier: LGPL-2.1-only AND GPL-2.0-only
# SPDX-FileCopyrightText: Copyright 2026 Gaël PORTAY
# SPDX-FileCopyrightText: The OpenEmbedded Contributors
#
# The help texts are stolen from the Patches and configuration for the
# linux-yocto kernel tree Source Repository.
#
# https://git.yoctoproject.org/yocto-kernel-cache/

menu "Kernel Features"

config HAS_KERNEL_FEATURES_DM_VERITY
	bool "Enable dm-verity"
	default y if HAS_IMAGE_CLASSES_DM_VERITY_IMG
	help
	  Enable dm-verity (device-mapper block integrity checking
	  target).

config KAS_INCLUDE_HAS_KERNEL_FEATURES_DM_VERITY
	string
	depends on HAS_KERNEL_FEATURES_DM_VERITY
	default "kernel-features/dm-verity.yaml"

config HAS_KERNEL_FEATURES_EFI
	bool "Enable EFI"
	default y if HAS_MACHINE_FEATURES_EFI
	help
	  Core EFI support.

config KAS_INCLUDE_HAS_KERNEL_FEATURES_EFI
	string
	depends on HAS_KERNEL_FEATURES_EFI
	default "kernel-features/efi.yaml"

endmenu
```

## kernel/Kconfig
```kconfig
# SPDX-License-Identifier: LGPL-2.1-only AND CC-BY-SA-2.0-UK
# SPDX-FileCopyrightText: Copyright 2026 Gaël PORTAY
# SPDX-FileCopyrightText: The OpenEmbedded Contributors
#
# The help texts are stolen from openembedded-core layer.
#
# https://github.com/openembedded/openembedded-core/blob/12b8b7aef5e709293a9ff5090841306d4e469c96/meta/conf/templates/default/local.conf.sample.extended#L313-L331

menu "Kernel"

config HAS_INITRAMFS_IMAGE
	bool "Use initramfs image"
	help
	  The INITRAMFS_IMAGE image variable will cause an additional
	  recipe to be built as a dependency to the what ever rootfs
	  recipe you might be using such as core-image-sato. The
	  initramfs might be needed for the initial boot of the target
	  system such as to load kernel modules prior to mounting the
	  root file system.

	  https://github.com/openembedded/openembedded-core/blob/12b8b7aef5e709293a9ff5090841306d4e469c96/meta/conf/templates/default/local.conf.sample.extended#L316-L320

if HAS_INITRAMFS_IMAGE

choice
	prompt "Initramfs FS type"
	default IS_INITRAMFS_FSTYPES_CPIO_GZ
	help
	  Defines the format for the output image of an initial RAM
	  filesystem (Initramfs), which is used during boot. Supported
	  formats are the same as those supported by the IMAGE_FSTYPES variable.

	  The default value of this variable, which is set in the
	  meta/conf/bitbake.conf configuration file in
	  OpenEmbedded-Core (OE-Core), is “cpio.gz”. The Linux kernel’s
	  Initramfs mechanism, as opposed to the initial RAM filesystem
	  initrd mechanism, expects an optionally compressed cpio
	  archive.


config IS_INITRAMFS_FSTYPE_CPIO_LZ4
	bool "cpio.lz4"

config IS_INITRAMFS_FSTYPE_CPIO_LZO
	bool "cpio.lzo"

config IS_INITRAMFS_FSTYPE_CPIO_LZMA
	bool "cpio.lzma"

config IS_INITRAMFS_FSTYPE_CPIO_XZ
	bool "cpio.xz"

config IS_INITRAMFS_FSTYPE_CPIO_ZST
	bool "cpio.zst"

config IS_INITRAMFS_FSTYPES_CPIO_GZ
	bool "cpio.gz"

config IS_INITRAMFS_FSTYPES_CPIO
	bool "cpio"

endchoice

config KAS_INCLUDE_HAS_INITRAMFS_FSTYPES
	string
	default "kernel/initramfs-fstypes-cpio-lz4.yaml" if IS_INITRAMFS_FSTYPE_CPIO_LZ4
	default "kernel/initramfs-fstypes-cpio-lzo.yaml" if IS_INITRAMFS_FSTYPE_CPIO_LZO
	default "kernel/initramfs-fstypes-cpio-lzma.yaml" if IS_INITRAMFS_FSTYPE_CPIO_LZMA
	default "kernel/initramfs-fstypes-cpio-xz.yaml" if IS_INITRAMFS_FSTYPE_CPIO_XZ
	default "kernel/initramfs-fstypes-cpio-zst.yaml" if IS_INITRAMFS_FSTYPE_CPIO_ZST
	default "kernel/initramfs-fstypes-cpio-gz.yaml" if IS_INITRAMFS_FSTYPE_CPIO_GZ
	default "kernel/initramfs-fstypes-cpio.yaml" if IS_INITRAMFS_FSTYPE_CPIO

choice
	prompt "Initramfs image"
	default IS_DM_VERITY_IMAGE_INITRAMFS if HAS_IMAGE_CLASSES_DM_VERITY_IMG
	default IS_CORE_IMAGE_MINIMAL_INITRAMFS

config IS_DM_VERITY_IMAGE_INITRAMFS
	bool "dm-verity-image-initramfs"
	help
	  Simple initramfs image for mounting the rootfs over the
	  verity device mapper.

config IS_CORE_IMAGE_MINIMAL_INITRAMFS
	bool "core-image-minimal-initramfs"
	help
	  Small image capable of booting a device. The kernel includes
	  the Minimal RAM-based Initial Root Filesystem (initramfs),
	  which finds the first 'init' program more efficiently.

endchoice

config KAS_INCLUDE_HAS_INITRAMFS_IMAGE
	string
	default "kernel/dm-verity-image-initramfs.yaml" if IS_DM_VERITY_IMAGE_INITRAMFS
	default "kernel/core-image-minimal-initramfs.yaml"

config HAS_INITRAMFS_IMAGE_BUNDLE
	bool "Bundle initramfs to kernel image"
	help
	  INITRAMFS_IMAGE_BUNDLE variable controls if the image recipe
	  specified by the INITRAMFS_IMAGE will be run through an extra
	  pass through the kernel compilation in order to build a
	  single binary which contains both the kernel image and the
	  initramfs.

	  https://github.com/openembedded/openembedded-core/blob/12b8b7aef5e709293a9ff5090841306d4e469c96/meta/conf/templates/default/local.conf.sample.extended#L322-L328

config KAS_INCLUDE_HAS_INITRAMFS_IMAGE_BUNDLE
	string
	depends on HAS_INITRAMFS_IMAGE_BUNDLE
	default "kernel/initramfs-image-bundle.yaml"

endif

endmenu
```

## layers/meta-cyclonedx/Kconfig
```kconfig
# SPDX-License-Identifier: LGPL-2.1-only
# SPDX-FileCopyrightText: Copyright 2026 Gaël PORTAY

config HAS_LAYER_META_CYCLONEDX
	bool "meta-cyclonedx"
	help
	  A Yocto meta-layer for generating CycloneDX SBOMs

config KAS_INCLUDE_HAS_LAYER_META_CYCLONEDX
	string
	depends on HAS_LAYER_META_CYCLONEDX
	default "layers/meta-cyclonedx/meta-cyclonedx.yaml"
```

## machine-features/Kconfig
```kconfig
# SPDX-License-Identifier: LGPL-2.1-only AND CC-BY-SA-2.0-UK
# SPDX-FileCopyrightText: Copyright 2026 Gaël PORTAY
# SPDX-FileCopyrightText: The OpenEmbedded Contributors
#
# The help texts are stolen from the Yocto Project Reference Manual.
#
# https://docs.yoctoproject.org/dev/ref-manual/features.html#machine-features

menu "Machine Features"

config HAS_MACHINE_FEATURES_EFI
	bool "Enable EFI"
	default y
	help
	  Support for booting through EFI.

config KAS_INCLUDE_HAS_MACHINES_FEATURE_EFI
	string
	depends on HAS_MACHINES_FEATURE_EFI
	default "machine-features/efi.yaml"

endmenu
```
